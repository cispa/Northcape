## CMakeLists.txt
```
# SPDX-License-Identifier: Apache-2.0

cmake_minimum_required(VERSION 3.20.0)
find_package(Zephyr REQUIRED HINTS $ENV{ZEPHYR_BASE})
project(latency_measure)

FILE(GLOB app_sources src/*.c)

if(CONFIG_SKADI_LOADER)
    create_skadi_subsystem_main(APP app SRCS ${app_sources} ${ZEPHYR_BASE}/subsys/timing/timing.c ${ZEPHYR_BASE}/arch/common/timing.c FPU)
else()
    target_sources(app PRIVATE ${app_sources})
endif()
```

## prj.conf
```kconfig
# Default base configuration file

CONFIG_TEST=y

# eliminate timer interrupts during the benchmark
CONFIG_SYS_CLOCK_TICKS_PER_SEC=1

# We use irq_offload(), enable it
CONFIG_IRQ_OFFLOAD=y

# Reduce memory/code footprint
CONFIG_BT=n
CONFIG_FORCE_NO_ASSERT=y

CONFIG_TEST_HW_STACK_PROTECTION=n
# Disable HW Stack Protection (see #28664)
CONFIG_HW_STACK_PROTECTION=n
CONFIG_COVERAGE=n

# Disable system power management
CONFIG_PM=n

CONFIG_TIMING_FUNCTIONS=y

CONFIG_HEAP_MEM_POOL_SIZE=2048
CONFIG_APPLICATION_DEFINED_SYSCALL=y

# Disable time slicing
CONFIG_TIMESLICING=n

# Enable events
CONFIG_EVENTS=y

# no networking - disable interruptions...
CONFIG_NETWORKING=n

# need to be able to at least print floats
CONFIG_SKADI_LIBC_SUPPORTS_FPU=y

# %s is used everywhere...
CONFIG_SKADI_LIBRARY_PRINTF_STRING_BYTES_OUT_SUPPORT=y

CONFIG_SPEED_OPTIMIZATIONS=y

CONFIG_REQUIRES_FLOAT_PRINTF=y
CONFIG_SKADI_COUNT_SUBSYSTEM_CALLS=y
CONFIG_SKADI_MARK_THREAD_IN_TRAMPOLINE=y

# needs to be big enough for result buffer on zephyr
CONFIG_TEST_EXTRA_STACK_SIZE=65024
```

## src/main.c
```c
/*
 * Copyright (c) 2012-2015 Wind River Systems, Inc.
 * Copyright (c) 2023,2024 Intel Corporation.
 *
 * SPDX-License-Identifier: Apache-2.0
 */

/*
 * @file
 * This file contains the main testing module that invokes all the tests.
 */

#include <zephyr/kernel.h>
#include <zephyr/timestamp.h>
#include "utils.h"
#include "timing_sc.h"
#include <zephyr/tc_util.h>
#include <zephyr/skadi/skadi_benchmark.h>

#define STACK_SIZE (1024 + CONFIG_TEST_EXTRA_STACK_SIZE)

uint32_t tm_off;

BENCH_BMEM struct timestamp_data  timestamp;

#ifdef CONFIG_USERSPACE
K_APPMEM_PARTITION_DEFINE(bench_mem_partition);
#endif

K_THREAD_STACK_DEFINE(start_stack, START_STACK_SIZE);
K_THREAD_STACK_DEFINE(alt_stack, ALT_STACK_SIZE);

K_SEM_DEFINE(pause_sem, 0, 1);

#if (CONFIG_MP_MAX_NUM_CPUS > 1)
struct k_thread  busy_thread[CONFIG_MP_MAX_NUM_CPUS - 1];

#define BUSY_THREAD_STACK_SIZE  (1024 + CONFIG_TEST_EXTRA_STACK_SIZE)

K_THREAD_STACK_DEFINE(busy_thread_stack, BUSY_THREAD_STACK_SIZE);
#endif

struct k_thread  start_thread;
struct k_thread  alt_thread;

int error_count; /* track number of errors */

extern void thread_switch_yield(uint32_t num_iterations, bool is_cooperative);
extern void int_to_thread(uint32_t num_iterations);
extern void sema_test_signal(uint32_t num_iterations, uint32_t options);
extern void mutex_lock_unlock(uint32_t num_iterations, uint32_t options);
extern void sema_context_switch(uint32_t num_iterations,
				uint32_t start_options, uint32_t alt_options);
extern int thread_ops(uint32_t num_iterations, uint32_t start_options,
		      uint32_t alt_options);
extern int fifo_ops(uint32_t num_iterations, uint32_t options);
extern int fifo_blocking_ops(uint32_t num_iterations, uint32_t start_options,
			     uint32_t alt_options);
extern int lifo_ops(uint32_t num_iterations, uint32_t options);
extern int lifo_blocking_ops(uint32_t num_iterations, uint32_t start_options,
			     uint32_t alt_options);
extern int event_ops(uint32_t num_iterations, uint32_t options);
extern int event_blocking_ops(uint32_t num_iterations, uint32_t start_options,
			      uint32_t alt_options);
extern int condvar_blocking_ops(uint32_t num_iterations, uint32_t start_options,
				uint32_t alt_options);
extern int stack_ops(uint32_t num_iterations, uint32_t options);
extern int stack_blocking_ops(uint32_t num_iterations, uint32_t start_options,
			       uint32_t alt_options);
extern void heap_malloc_free(void);

#if (CONFIG_MP_MAX_NUM_CPUS > 1)
static void busy_thread_entry(void *arg1, void *arg2, void *arg3)
{
	while (1) {
	}
}
#endif

#ifdef SKADI_SUBSYSTEM
SKADI_SUBSYSTEM_CALLEE_TRAMPOLINE(void, test_thread, void *p1, void *p2, void *p3)
#else
static void test_thread(void *p1, void *p2, void *p3)
#endif
{
	uint32_t freq;

	ARG_UNUSED(p1);
	ARG_UNUSED(p2);
	ARG_UNUSED(p3);

#ifdef SKADI_SUBSYSTEM
	skadi_sem_init(&pause_sem, 0, 1);
#endif

#if (CONFIG_MP_MAX_NUM_CPUS > 1)
	/* Spawn busy threads that will execute on the other cores */

	for (uint32_t i = 0; i < CONFIG_MP_MAX_NUM_CPUS - 1; i++) {
		k_thread_create(&busy_thread[i], &busy_thread_stack[i],
				BUSY_THREAD_STACK_SIZE, busy_thread_entry,
				NULL, NULL, NULL,
				K_HIGHEST_THREAD_PRIO, 0, K_NO_WAIT);
	}
#endif

#ifdef CONFIG_USERSPACE
	k_mem_domain_add_partition(&k_mem_domain_default,
				   &bench_mem_partition);
#endif

	timing_init();

	skadi_perf_start(10000);

	bench_test_init();

	freq = timing_freq_get_mhz();

	TC_START("Time Measurement");
	TC_PRINT("Timing results: Clock frequency: %u MHz\n", freq);

	timestamp_overhead_init(CONFIG_BENCHMARK_NUM_ITERATIONS);

	/* Preemptive threads context switching */
	thread_switch_yield(CONFIG_BENCHMARK_NUM_ITERATIONS, false);

	/* Cooperative threads context switching */
	thread_switch_yield(CONFIG_BENCHMARK_NUM_ITERATIONS, true);

	int_to_thread(CONFIG_BENCHMARK_NUM_ITERATIONS);

	/* Thread creation, starting, suspending, resuming and aborting. */

	thread_ops(CONFIG_BENCHMARK_NUM_ITERATIONS, 0, 0);
#ifdef CONFIG_USERSPACE
	thread_ops(CONFIG_BENCHMARK_NUM_ITERATIONS, 0, K_USER);
	thread_ops(CONFIG_BENCHMARK_NUM_ITERATIONS, K_USER, K_USER);
	thread_ops(CONFIG_BENCHMARK_NUM_ITERATIONS, K_USER, 0);
#endif

	fifo_ops(CONFIG_BENCHMARK_NUM_ITERATIONS, 0);
#ifdef CONFIG_USERSPACE
	fifo_ops(CONFIG_BENCHMARK_NUM_ITERATIONS, K_USER);
#endif

	fifo_blocking_ops(CONFIG_BENCHMARK_NUM_ITERATIONS, 0, 0);
#ifdef CONFIG_USERSPACE
	fifo_blocking_ops(CONFIG_BENCHMARK_NUM_ITERATIONS, 0, K_USER);
	fifo_blocking_ops(CONFIG_BENCHMARK_NUM_ITERATIONS, K_USER, 0);
	fifo_blocking_ops(CONFIG_BENCHMARK_NUM_ITERATIONS, K_USER, K_USER);
#endif


	lifo_ops(CONFIG_BENCHMARK_NUM_ITERATIONS, 0);
#ifdef CONFIG_USERSPACE
	lifo_ops(CONFIG_BENCHMARK_NUM_ITERATIONS, K_USER);
#endif

	lifo_blocking_ops(CONFIG_BENCHMARK_NUM_ITERATIONS, 0, 0);
#ifdef CONFIG_USERSPACE
	lifo_blocking_ops(CONFIG_BENCHMARK_NUM_ITERATIONS, 0, K_USER);
	lifo_blocking_ops(CONFIG_BENCHMARK_NUM_ITERATIONS, K_USER, 0);
	lifo_blocking_ops(CONFIG_BENCHMARK_NUM_ITERATIONS, K_USER, K_USER);
#endif

	event_ops(CONFIG_BENCHMARK_NUM_ITERATIONS, 0);
#ifdef CONFIG_USERSPACE
	event_ops(CONFIG_BENCHMARK_NUM_ITERATIONS, K_USER);
#endif

	event_blocking_ops(CONFIG_BENCHMARK_NUM_ITERATIONS, 0, 0);
#ifdef CONFIG_USERSPACE
	event_blocking_ops(CONFIG_BENCHMARK_NUM_ITERATIONS, 0, K_USER);
	event_blocking_ops(CONFIG_BENCHMARK_NUM_ITERATIONS, K_USER, 0);
	event_blocking_ops(CONFIG_BENCHMARK_NUM_ITERATIONS, K_USER, K_USER);
#endif

	sema_test_signal(CONFIG_BENCHMARK_NUM_ITERATIONS, 0);
#ifdef CONFIG_USERSPACE
	sema_test_signal(CONFIG_BENCHMARK_NUM_ITERATIONS, K_USER);
#endif

	sema_context_switch(CONFIG_BENCHMARK_NUM_ITERATIONS, 0, 0);
#ifdef CONFIG_USERSPACE
	sema_context_switch(CONFIG_BENCHMARK_NUM_ITERATIONS, 0, K_USER);
	sema_context_switch(CONFIG_BENCHMARK_NUM_ITERATIONS, K_USER, 0);
	sema_context_switch(CONFIG_BENCHMARK_NUM_ITERATIONS, K_USER, K_USER);
#endif

	condvar_blocking_ops(CONFIG_BENCHMARK_NUM_ITERATIONS, 0, 0);
#ifdef CONFIG_USERSPACE
	condvar_blocking_ops(CONFIG_BENCHMARK_NUM_ITERATIONS, 0, K_USER);
	condvar_blocking_ops(CONFIG_BENCHMARK_NUM_ITERATIONS, K_USER, 0);
	condvar_blocking_ops(CONFIG_BENCHMARK_NUM_ITERATIONS, K_USER, K_USER);
#endif

	stack_ops(CONFIG_BENCHMARK_NUM_ITERATIONS, 0);
#ifdef CONFIG_USERSPACE
	stack_ops(CONFIG_BENCHMARK_NUM_ITERATIONS, K_USER);
#endif

	stack_blocking_ops(CONFIG_BENCHMARK_NUM_ITERATIONS, 0, 0);
#ifdef CONFIG_USERSPACE
	stack_blocking_ops(CONFIG_BENCHMARK_NUM_ITERATIONS, 0, K_USER);
	stack_blocking_ops(CONFIG_BENCHMARK_NUM_ITERATIONS, K_USER, 0);
	stack_blocking_ops(CONFIG_BENCHMARK_NUM_ITERATIONS, K_USER, K_USER);
#endif

	mutex_lock_unlock(CONFIG_BENCHMARK_NUM_ITERATIONS, 0);
#ifdef CONFIG_USERSPACE
	mutex_lock_unlock(CONFIG_BENCHMARK_NUM_ITERATIONS, K_USER);
#endif

	heap_malloc_free();

	skadi_perf_cancel();

	TC_END_REPORT(error_count);
}
#ifdef SKADI_SUBSYSTEM
SKADI_SUBSYSTEM_CALLEE_TRAMPOLINE_END(test_thread)
#endif

#ifdef SKADI_SUBSYSTEM
k_tid_t test_thread_id;
static struct k_thread test_thread;
static K_THREAD_STACK_DEFINE(test_thread_stack, STACK_SIZE);

SKADI_SUBSYSTEM_MAIN(void)
{
	struct skadi_thread_create_params params;

	params.new_thread = &test_thread;
	params.stack = test_thread_stack;
	params.stack_size = K_THREAD_STACK_SIZEOF(test_thread_stack);
	params.entry = SKADI_SUBSYSTEM_FUNCTION_POINTER(test_thread);

	params.p1 = NULL;
	params.p2 = NULL;
	params.p3 = NULL;
	params.prio = K_PRIO_PREEMPT(10);
	params.options = 0;
	params.delay = K_NO_WAIT;

	test_thread_id = skadi_thread_create(&params);

	__ASSERT_NO_MSG(test_thread_id);

	skadi_thread_join(test_thread_id, K_FOREVER);
	return 0;
}
SKADI_SUBSYSTEM_MAIN_END
#else
K_THREAD_DEFINE(test_thread_id, STACK_SIZE, test_thread, NULL, NULL, NULL,
		K_PRIO_PREEMPT(10), 0, 0);

int main(void)
{
	k_thread_join(test_thread_id, K_FOREVER);
	return 0;
}
#endif
```

## src/condvar.c
```c
/*
 * Copyright (c) 2024 Intel Corporation
 *
 * SPDX-License-Identifier: Apache-2.0
 */

/*
 * @file measure time for various condition variable operations
 * 1. Block waiting for a condition variable
 * 2. Signal a condition variable (with context switch)
 */

#include <zephyr/kernel.h>
#include <zephyr/timing/timing.h>
#include "utils.h"
#include "timing_sc.h"

#ifdef SKADI_SUBSYSTEM
#include <zephyr/skadi/skadi_condvar.h>
#include <zephyr/skadi/skadi_mutex.h>
#include <zephyr/skadi/skadi_sched.h>
#endif

static K_CONDVAR_DEFINE(condvar);
static K_MUTEX_DEFINE(mutex);

static struct skadi_benchmark_state condvar_samples_1[CONFIG_BENCHMARK_NUM_ITERATIONS], condvar_samples_2[CONFIG_BENCHMARK_NUM_ITERATIONS];

#ifdef SKADI_SUBSYSTEM
SKADI_SUBSYSTEM_CALLEE_TRAMPOLINE(void, condvar_start_thread_entry, void *p1, void *p2, void *p3)
#else
static void condvar_start_thread_entry(void *p1, void *p2, void *p3)
#endif
{
	uint32_t  num_iterations = (uint32_t)(uintptr_t)p1;
	uint32_t  i;
	timing_t  start;
	timing_t  finish;
	uint64_t  sum[2] = {0ull, 0ull};

#ifdef SKADI_SUBSYSTEM
	skadi_mutex_lock(&mutex, K_FOREVER);

	skadi_thread_start(&alt_thread);
#else
	k_mutex_lock(&mutex, K_FOREVER);

	k_thread_start(&alt_thread);
#endif

	for (i = 0; i < num_iterations; i++) {
		/* 1. Get the first timestamp and block on condvar */

		skadi_benchmark_prepare_sample(&condvar_samples_1[i]);
		skadi_benchmark_prepare_sample(&condvar_samples_2[i]);

		start = timing_timestamp_get();
#ifdef SKADI_SUBSYSTEM
		skadi_condvar_wait(&condvar, &mutex, K_FOREVER);
#else
		k_condvar_wait(&condvar, &mutex, K_FOREVER);
#endif

		/* 3. Get the final timstamp */

		finish = timing_timestamp_get();

		sum[0] += timing_cycles_get(&start, &timestamp.sample);
		sum[1] += timing_cycles_get(&timestamp.sample, &finish);

		skadi_benchmark_add_sample(&condvar_samples_1[i], timing_cycles_to_ns(timing_cycles_get(&start, &timestamp.sample)));
		skadi_benchmark_add_sample(&condvar_samples_2[i], timing_cycles_to_ns(timing_cycles_get(&timestamp.sample, &finish)));
	}

	/* Wait for alt_thread to finish */

#ifdef SKADI_SUBSYSTEM
	skadi_thread_join(&alt_thread, K_FOREVER);
	skadi_thread_cleanup(&alt_thread);
#else
	k_thread_join(&alt_thread, K_FOREVER);
#endif

	timestamp.cycles = sum[0];
#ifdef SKADI_SUBSYSTEM
	skadi_sem_take(&pause_sem, K_FOREVER);
#else
	k_sem_take(&pause_sem, K_FOREVER);
#endif

	timestamp.cycles = sum[1];
}
#ifdef SKADI_SUBSYSTEM
SKADI_SUBSYSTEM_CALLEE_TRAMPOLINE_END(condvar_start_thread_entry)
#endif

#ifdef SKADI_SUBSYSTEM
SKADI_SUBSYSTEM_CALLEE_TRAMPOLINE(void, condvar_alt_thread_entry, void *p1, void *p2, void *p3)
#else
static void condvar_alt_thread_entry(void *p1, void *p2, void *p3)
#endif
{
	uint32_t  num_iterations = (uint32_t)(uintptr_t)p1;
	uint32_t  i;

	for (i = 0; i < num_iterations; i++) {

		/* 2. Get midpoint timestamp and signal the condvar */

		timestamp.sample = timing_timestamp_get();
#ifdef SKADI_SUBSYSTEM
		skadi_condvar_signal(&condvar);
#else
		k_condvar_signal(&condvar);
#endif
	}
}
#ifdef SKADI_SUBSYSTEM
SKADI_SUBSYSTEM_CALLEE_TRAMPOLINE_END(condvar_alt_thread_entry)
#endif


int condvar_blocking_ops(uint32_t num_iterations, uint32_t start_options,
			 uint32_t alt_options)
{
	int       priority;
	char      tag[50];
	char      description[120];
	uint64_t  cycles;

#ifdef SKADI_SUBSYSTEM
	struct skadi_thread_create_params params;

	skadi_mutex_init(&mutex);
	skadi_condvar_init(&condvar);
#endif

#ifdef SKADI_SUBSYSTEM
	priority = skadi_thread_priority_get(skadi_current_get());
#else
	priority = k_thread_priority_get(k_current_get());
#endif

	timing_start();

#ifdef SKADI_SUBSYSTEM
	params.new_thread = &start_thread;
	params.stack = start_stack;
	params.stack_size = K_THREAD_STACK_SIZEOF(start_stack);
	params.entry = SKADI_SUBSYSTEM_FUNCTION_POINTER(condvar_start_thread_entry);

	params.p1 = (void *)(uintptr_t)num_iterations;
	params.p2 = NULL;
	params.p3 = NULL;
	params.prio = priority - 2;
	params.options = start_options;
	params.delay = K_FOREVER;

	skadi_thread_create(&params);

	params.new_thread = &alt_thread;
	params.stack = alt_stack;
	params.stack_size = K_THREAD_STACK_SIZEOF(alt_stack);
	params.entry = SKADI_SUBSYSTEM_FUNCTION_POINTER(condvar_alt_thread_entry);

	params.p1 = (void *)(uintptr_t)num_iterations;
	params.p2 = NULL;
	params.p3 = NULL;
	params.prio = priority - 1;
	params.options = alt_options;
	params.delay = K_FOREVER;

	skadi_thread_create(&params);
#else
	k_thread_create(&start_thread, start_stack,
			K_THREAD_STACK_SIZEOF(start_stack),
			condvar_start_thread_entry,
			(void *)(uintptr_t)num_iterations,
			NULL, NULL,
			priority - 2, start_options, K_FOREVER);

	k_thread_create(&alt_thread, alt_stack,
			K_THREAD_STACK_SIZEOF(alt_stack),
			condvar_alt_thread_entry,
			(void *)(uintptr_t)num_iterations,
			NULL, NULL,
			priority - 1, alt_options, K_FOREVER);
#endif

	k_thread_access_grant(&start_thread, &alt_thread,
			      &condvar, &mutex, &pause_sem);
	k_thread_access_grant(&alt_thread, &condvar);

	/* Start test thread */
#ifdef SKADI_SUBSYSTEM
	skadi_thread_start(&start_thread);
#else
	k_thread_start(&start_thread);
#endif

	/* Stats gathered. Display them. */

	snprintf(tag, sizeof(tag), "condvar.wait.blocking.%c_to_%c",
		 (start_options & K_USER) ? 'u' : 'k',
		 (alt_options & K_USER) ? 'u' : 'k');
	snprintf(description, sizeof(description),
		 "%-40s - Wait for a condvar (context switch)", tag);

	cycles = timestamp.cycles;
	PRINT_STATS_AVG(description, (uint32_t)cycles,
			num_iterations, false, "");

	
	skadi_benchmark_evaluate_samples(condvar_samples_1, CONFIG_BENCHMARK_NUM_ITERATIONS, 0, description);

#ifdef SKADI_SUBSYSTEM
	skadi_sem_give(&pause_sem);
#else
	k_sem_give(&pause_sem);
#endif

	snprintf(tag, sizeof(tag), "condvar.signal.wake+ctx.%c_to_%c",
		 (alt_options & K_USER) ? 'u' : 'k',
		 (start_options & K_USER) ? 'u' : 'k');
	snprintf(description, sizeof(description),
		 "%-40s - Signal a condvar (context switch)", tag);
	cycles = timestamp.cycles;
	PRINT_STATS_AVG(description, (uint32_t)cycles,
			num_iterations, false, "");
	
	skadi_benchmark_evaluate_samples(condvar_samples_2, CONFIG_BENCHMARK_NUM_ITERATIONS, 0, description);

#ifdef SKADI_SUBSYSTEM
	skadi_thread_join(&start_thread, K_FOREVER);
	skadi_thread_cleanup(&start_thread);
#else
	k_thread_join(&start_thread, K_FOREVER);
#endif

	timing_stop();

	return 0;
}
```

## src/events.c
```c
/*
 * Copyright (c) 2024 Intel Corporation
 *
 * SPDX-License-Identifier: Apache-2.0
 */

/*
 * @file measure time for various event operations
 *
 * This file contains the tests that measure the times for manipulating
 * event objects from both kernel and user threads:
 * 1. Immediately posting and setting events
 * 2. Immediately receiving any or all events.
 * 3. Blocking to receive either any or all events.
 * 4. Waking (and switching to) a thread waiting for any or all events.
 */

#include <zephyr/kernel.h>
#include <zephyr/timing/timing.h>
#include "utils.h"
#include "timing_sc.h"

#ifdef SKADI_SUBSYSTEM
#include <zephyr/skadi/skadi_event.h>
#endif

#define BENCH_EVENT_SET  0x1234
#define ALL_EVENTS       0xFFFFFFFF

static K_EVENT_DEFINE(event_set);

static struct skadi_benchmark_state event_samples_1[CONFIG_BENCHMARK_NUM_ITERATIONS],
			   event_samples_2[CONFIG_BENCHMARK_NUM_ITERATIONS],
			   event_samples_3[CONFIG_BENCHMARK_NUM_ITERATIONS],
			   event_samples_4[CONFIG_BENCHMARK_NUM_ITERATIONS],
			   event_samples_5[CONFIG_BENCHMARK_NUM_ITERATIONS],
			   event_samples_6[CONFIG_BENCHMARK_NUM_ITERATIONS],
			   event_samples_7[CONFIG_BENCHMARK_NUM_ITERATIONS],
			   event_samples_8[CONFIG_BENCHMARK_NUM_ITERATIONS];

#ifdef SKADI_SUBSYSTEM
SKADI_SUBSYSTEM_CALLEE_TRAMPOLINE(void, event_ops_entry, void *p1, void *p2, void *p3)
#else
static void event_ops_entry(void *p1, void *p2, void *p3)
#endif
{
	uint32_t  num_iterations = (uint32_t)(uintptr_t)p1;
	timing_t  start;
	timing_t  finish;
	uint32_t  i;

	/* 2. Benchmark k_event_post() with no waiters */
#ifdef SKADI_SUBSYSTEM
	skadi_event_clear(&event_set, ALL_EVENTS);
#else
	k_event_clear(&event_set, ALL_EVENTS);
#endif

	
	for (i = 0; i < num_iterations; i++) {
		skadi_benchmark_prepare_sample(&event_samples_1[i]);
		start = timing_timestamp_get();
#ifdef SKADI_SUBSYSTEM
		skadi_event_post(&event_set, BENCH_EVENT_SET);
#else
		k_event_post(&event_set, BENCH_EVENT_SET);
#endif
		finish = timing_timestamp_get();
		skadi_benchmark_add_sample(&event_samples_1[i], timing_cycles_to_ns(timing_cycles_get(&start, &finish)));
	}

	timestamp.cycles = timing_cycles_get(&start, &finish);

	/* 3. Pause to allow main thread to print results */
#ifdef SKADI_SUBSYSTEM
	skadi_sem_take(&pause_sem, K_FOREVER);
#else
	k_sem_take(&pause_sem, K_FOREVER);
#endif

	/* 5. Benchmark k_event_set() with no waiters */

	
	for (i = 0; i < num_iterations; i++) {
		skadi_benchmark_prepare_sample(&event_samples_2[i]);
		start = timing_timestamp_get();
#ifdef SKADI_SUBSYSTEM
		skadi_event_set(&event_set, BENCH_EVENT_SET);
#else
		k_event_set(&event_set, BENCH_EVENT_SET);
#endif
		finish = timing_timestamp_get();
		skadi_benchmark_add_sample(&event_samples_2[i], timing_cycles_to_ns(timing_cycles_get(&start, &finish)));
	}

	timestamp.cycles = timing_cycles_get(&start, &finish);

	/* 6. Pause to allow main thread to print results */
#ifdef SKADI_SUBSYSTEM
	skadi_sem_take(&pause_sem, K_FOREVER);
#else
	k_sem_take(&pause_sem, K_FOREVER);
#endif

	/* 8. Benchmark k_event_wait() (events have already been set) */

	for (i = 0; i < num_iterations; i++) {
		skadi_benchmark_prepare_sample(&event_samples_3[i]);
		start = timing_timestamp_get();
#ifdef SKADI_SUBSYSTEM
		skadi_event_wait(&event_set, BENCH_EVENT_SET, false, K_FOREVER);
#else
		k_event_wait(&event_set, BENCH_EVENT_SET, false, K_FOREVER);
#endif
		finish = timing_timestamp_get();
		skadi_benchmark_add_sample(&event_samples_3[i], timing_cycles_to_ns(timing_cycles_get(&start, &finish)));
	}

	timestamp.cycles = timing_cycles_get(&start, &finish);

	/* 9. Pause to allow main thread to print results */

#ifdef SKADI_SUBSYSTEM
	skadi_sem_take(&pause_sem, K_FOREVER);
#else
	k_sem_take(&pause_sem, K_FOREVER);
#endif

	/* 11. Benchmark k_event_wait_all() (events have already been set) */

	for (i = 0; i < num_iterations; i++) {
		skadi_benchmark_prepare_sample(&event_samples_4[i]);
		start = timing_timestamp_get();
#ifdef SKADI_SUBSYSTEM
		skadi_event_wait_all(&event_set, BENCH_EVENT_SET, false, K_FOREVER);
#else
		k_event_wait_all(&event_set, BENCH_EVENT_SET, false, K_FOREVER);
#endif
		finish = timing_timestamp_get();
		skadi_benchmark_add_sample(&event_samples_4[i], timing_cycles_to_ns(timing_cycles_get(&start, &finish)));
	}

	timestamp.cycles = timing_cycles_get(&start, &finish);

	/* 12. Thread finishes */
}
#ifdef SKADI_SUBSYSTEM
SKADI_SUBSYSTEM_CALLEE_TRAMPOLINE_END(event_ops_entry);
#endif

#ifdef SKADI_SUBSYSTEM
SKADI_SUBSYSTEM_CALLEE_TRAMPOLINE(void, events_start_thread_entry, void *p1, void *p2, void *p3)
#else
static void start_thread_entry(void *p1, void *p2, void *p3)
#endif
{
	uint32_t  num_iterations = (uint32_t)(uintptr_t)p1;
	uint32_t  i;
#ifdef SKADI_SUBSYSTEM
	skadi_thread_start(&alt_thread);
#else
	k_thread_start(&alt_thread);
#endif

	for (i = 0; i < num_iterations; i++) {

		/* 2. Set the events to wake alt_thread */

		timestamp.sample = timing_timestamp_get();
#ifdef SKADI_SUBSYSTEM
		skadi_event_set(&event_set, BENCH_EVENT_SET);
#else
		k_event_set(&event_set, BENCH_EVENT_SET);
#endif
	}

	for (i = 0; i < num_iterations; i++) {

		/* 5. Post the events to wake alt_thread */

		timestamp.sample = timing_timestamp_get();
#ifdef SKADI_SUBSYSTEM
		skadi_event_post(&event_set, BENCH_EVENT_SET);
#else
		k_event_post(&event_set, BENCH_EVENT_SET);
#endif
	}

#ifdef SKADI_SUBSYSTEM
	skadi_thread_join(&alt_thread, K_FOREVER);
	skadi_thread_cleanup(&alt_thread);
#else
	k_thread_join(&alt_thread, K_FOREVER);
#endif
}
#ifdef SKADI_SUBSYSTEM
SKADI_SUBSYSTEM_CALLEE_TRAMPOLINE_END(events_start_thread_entry)
#endif

#ifdef SKADI_SUBSYSTEM
SKADI_SUBSYSTEM_CALLEE_TRAMPOLINE(void, events_alt_thread_entry, void *p1, void *p2, void *p3)
#else
static void alt_thread_entry(void *p1, void *p2, void *p3)
#endif
{
	uint32_t  num_iterations = (uint32_t)(uintptr_t)p1;
	uint32_t  i;
	timing_t  start;
	timing_t  mid;
	timing_t  finish;
	uint64_t  sum[4] = {0ULL, 0ULL, 0ULL, 0ULL};

	for (i = 0; i < num_iterations; i++) {
		skadi_benchmark_prepare_sample(&event_samples_5[i]);
		skadi_benchmark_prepare_sample(&event_samples_6[i]);

		/* 1. Wait for any of the events */

		start = timing_timestamp_get();
#ifdef SKADI_SUBSYSTEM
		skadi_event_wait(&event_set, BENCH_EVENT_SET, true, K_FOREVER);
#else
		k_event_wait(&event_set, BENCH_EVENT_SET, true, K_FOREVER);
#endif

		/* 3. Record the final timestamp */

		finish = timing_timestamp_get();
		mid = timestamp.sample;

		sum[0] += timing_cycles_get(&start, &mid);
		sum[1] += timing_cycles_get(&mid, &finish);


		skadi_benchmark_add_sample(&event_samples_5[i], timing_cycles_to_ns(timing_cycles_get(&start, &mid)));
		skadi_benchmark_add_sample(&event_samples_6[i], timing_cycles_to_ns(timing_cycles_get(&mid, &finish)));
	}

	for (i = 0; i < num_iterations; i++) {
		skadi_benchmark_prepare_sample(&event_samples_7[i]);
		skadi_benchmark_prepare_sample(&event_samples_8[i]);

		/* 4. Wait for all of the events */

		start = timing_timestamp_get();
#ifdef SKADI_SUBSYSTEM
		skadi_event_wait_all(&event_set, BENCH_EVENT_SET, true, K_FOREVER);
#else
		k_event_wait_all(&event_set, BENCH_EVENT_SET, true, K_FOREVER);
#endif

		/* 6. Record the final timestamp */

		finish = timing_timestamp_get();
		mid = timestamp.sample;

		sum[2] += timing_cycles_get(&start, &mid);
		sum[3] += timing_cycles_get(&mid, &finish);

		skadi_benchmark_add_sample(&event_samples_7[i], timing_cycles_to_ns(timing_cycles_get(&start, &mid)));
		skadi_benchmark_add_sample(&event_samples_8[i], timing_cycles_to_ns(timing_cycles_get(&mid, &finish)));
	}

	/* Let the main thread print the results */

	timestamp.cycles = sum[0];
#ifdef SKADI_SUBSYSTEM
	skadi_sem_take(&pause_sem, K_FOREVER);
#else
	k_sem_take(&pause_sem, K_FOREVER);
#endif

	timestamp.cycles = sum[1];
#ifdef SKADI_SUBSYSTEM
	skadi_sem_take(&pause_sem, K_FOREVER);
#else
	k_sem_take(&pause_sem, K_FOREVER);
#endif

	timestamp.cycles = sum[2];
#ifdef SKADI_SUBSYSTEM
	skadi_sem_take(&pause_sem, K_FOREVER);
#else
	k_sem_take(&pause_sem, K_FOREVER);
#endif

	timestamp.cycles = sum[3];
}
#ifdef SKADI_SUBSYSTEM
SKADI_SUBSYSTEM_CALLEE_TRAMPOLINE_END(events_alt_thread_entry)
#endif

int event_ops(uint32_t num_iterations, uint32_t options)
{
	int       priority;
	char      tag[50];
	char      description[120];
	uint64_t  cycles;

#ifdef SKADI_SUBSYSTEM
	struct skadi_thread_create_params params;

	skadi_event_init(&event_set);

	priority = skadi_thread_priority_get(skadi_current_get());
#else
	priority = k_thread_priority_get(k_current_get());
#endif
	timing_start();

#ifdef SKADI_SUBSYSTEM
	params.new_thread = &start_thread;
	params.stack = start_stack;
	params.stack_size = K_THREAD_STACK_SIZEOF(start_stack);
	params.entry = SKADI_SUBSYSTEM_FUNCTION_POINTER(event_ops_entry);

	params.p1 = (void *)(uintptr_t)num_iterations;
	params.p2 = NULL;
	params.p3 = NULL;
	params.prio = priority - 1;
	params.options = options;
	params.delay = K_FOREVER;

	skadi_thread_create(&params);
#else
	k_thread_create(&start_thread, start_stack,
			K_THREAD_STACK_SIZEOF(start_stack),
			event_ops_entry,
			(void *)(uintptr_t)num_iterations,
			NULL, NULL,
			priority - 1, options, K_FOREVER);
#endif

	k_thread_access_grant(&start_thread, &event_set, &pause_sem);

	/* 1. Start test thread */
#ifdef SKADI_SUBSYSTEM
	skadi_thread_start(&start_thread);
#else
	k_thread_start(&start_thread);
#endif

	/* 4. Benchmark thread has paused */

	snprintf(tag, sizeof(tag), "events.post.immediate.%s",
		 (options & K_USER) ? "user" : "kernel");
	snprintf(description, sizeof(description),
		 "%-40s - Post events (nothing wakes)", tag);

	cycles = timestamp.cycles;
	PRINT_STATS_AVG(description, (uint32_t)cycles,
			num_iterations, false, "");
	
	skadi_benchmark_evaluate_samples(event_samples_1, CONFIG_BENCHMARK_NUM_ITERATIONS, 0, description);

#ifdef SKADI_SUBSYSTEM
	skadi_sem_give(&pause_sem);
#else
	k_sem_give(&pause_sem);
#endif

	/* 7. Benchmark thread has paused */

	snprintf(tag, sizeof(tag), "events.set.immediate.%s",
		 (options & K_USER) ? "user" : "kernel");
	snprintf(description, sizeof(description),
		 "%-40s - Set events (nothing wakes)", tag);
	cycles = timestamp.cycles;
	PRINT_STATS_AVG(description, (uint32_t)cycles,
			num_iterations, false, "");
	
	skadi_benchmark_evaluate_samples(event_samples_2, CONFIG_BENCHMARK_NUM_ITERATIONS, 0, description);

#ifdef SKADI_SUBSYSTEM
	skadi_sem_give(&pause_sem);
#else
	k_sem_give(&pause_sem);
#endif

	/* 10. Benchmark thread has paused */

	snprintf(tag, sizeof(tag), "events.wait.immediate.%s",
		 (options & K_USER) ? "user" : "kernel");
	snprintf(description, sizeof(description),
		 "%-40s - Wait for any events (no ctx switch)", tag);
	cycles = timestamp.cycles;
	PRINT_STATS_AVG(description, (uint32_t)cycles,
			num_iterations, false, "");

	skadi_benchmark_evaluate_samples(event_samples_3, CONFIG_BENCHMARK_NUM_ITERATIONS, 0, description);

#ifdef SKADI_SUBSYSTEM
	skadi_sem_give(&pause_sem);
#else
	k_sem_give(&pause_sem);
#endif

	/* 13. Benchmark thread has finished */

	snprintf(tag, sizeof(tag), "events.wait_all.immediate.%s",
		 (options & K_USER) ? "user" : "kernel");
	snprintf(description, sizeof(description),
		 "%-40s - Wait for all events (no ctx switch)", tag);
	cycles = timestamp.cycles;
	PRINT_STATS_AVG(description, (uint32_t)cycles,
			num_iterations, false, "");
	
	skadi_benchmark_evaluate_samples(event_samples_4, CONFIG_BENCHMARK_NUM_ITERATIONS, 0, description);

#ifdef SKADI_SUBSYSTEM
	skadi_thread_join(&start_thread, K_FOREVER);
	skadi_thread_cleanup(&start_thread);
#else
	k_thread_join(&start_thread, K_FOREVER);
#endif

	timing_stop();

	return 0;
}

int event_blocking_ops(uint32_t num_iterations, uint32_t start_options,
		       uint32_t alt_options)
{
	int       priority;
	char      tag[50];
	char      description[120];
	uint64_t  cycles;

#ifdef SKADI_SUBSYSTEM
	struct skadi_thread_create_params params;

	priority = skadi_thread_priority_get(skadi_current_get());
#else
	priority = k_thread_priority_get(k_current_get());
#endif

	timing_start();

#ifdef SKADI_SUBSYSTEM
	params.new_thread = &start_thread;
	params.stack = start_stack;
	params.stack_size = K_THREAD_STACK_SIZEOF(start_stack);
	params.entry = SKADI_SUBSYSTEM_FUNCTION_POINTER(events_start_thread_entry);

	params.p1 = (void *)(uintptr_t)num_iterations;
	params.p2 = NULL;
	params.p3 = NULL;
	params.prio = priority - 1;
	params.options = start_options;
	params.delay = K_FOREVER;

	skadi_thread_create(&params);

	params.new_thread = &alt_thread;
	params.stack = alt_stack;
	params.stack_size = K_THREAD_STACK_SIZEOF(alt_stack);
	params.entry = SKADI_SUBSYSTEM_FUNCTION_POINTER(events_alt_thread_entry);

	params.prio = priority - 2;
	params.options = alt_options;

	skadi_thread_create(&params);
#else
	k_thread_create(&start_thread, start_stack,
			K_THREAD_STACK_SIZEOF(start_stack),
			start_thread_entry,
			(void *)(uintptr_t)num_iterations,
			NULL, NULL,
			priority - 1, start_options, K_FOREVER);

	k_thread_create(&alt_thread, alt_stack,
			K_THREAD_STACK_SIZEOF(alt_stack),
			alt_thread_entry,
			(void *)(uintptr_t)num_iterations,
			NULL, NULL,
			priority - 2, alt_options, K_FOREVER);
#endif

	k_thread_access_grant(&start_thread, &alt_thread, &event_set,
			      &pause_sem);
	k_thread_access_grant(&alt_thread, &event_set, &pause_sem);

#ifdef SKADI_SUBSYSTEM
	skadi_thread_start(&start_thread);
#else
	k_thread_start(&start_thread);
#endif

	snprintf(tag, sizeof(tag),
		 "events.wait.blocking.%c_to_%c",
		 (alt_options & K_USER) ? 'u' : 'k',
		 (start_options & K_USER) ? 'u' : 'k');
	snprintf(description, sizeof(description),
		 "%-40s - Wait for any events (w/ ctx switch)", tag);
	cycles = timestamp.cycles -
		 timestamp_overhead_adjustment(start_options, alt_options);
	PRINT_STATS_AVG(description, (uint32_t)cycles,
			num_iterations, false, "");
	skadi_benchmark_evaluate_samples(event_samples_5, CONFIG_BENCHMARK_NUM_ITERATIONS, 0, description);
#ifdef SKADI_SUBSYSTEM
	skadi_sem_give(&pause_sem);
#else
	k_sem_give(&pause_sem);
#endif

	snprintf(tag, sizeof(tag),
		 "events.set.wake+ctx.%c_to_%c",
		 (start_options & K_USER) ? 'u' : 'k',
		 (alt_options & K_USER) ? 'u' : 'k');
	snprintf(description, sizeof(description),
		 "%-40s - Set events (w/ ctx switch)", tag);
	cycles = timestamp.cycles -
		 timestamp_overhead_adjustment(start_options, alt_options);
	PRINT_STATS_AVG(description, (uint32_t)cycles,
			num_iterations, false, "");
	skadi_benchmark_evaluate_samples(event_samples_6, CONFIG_BENCHMARK_NUM_ITERATIONS, 0, description);
#ifdef SKADI_SUBSYSTEM
	skadi_sem_give(&pause_sem);
#else
	k_sem_give(&pause_sem);
#endif

	snprintf(tag, sizeof(tag),
		 "events.wait_all.blocking.%c_to_%c",
		 (alt_options & K_USER) ? 'u' : 'k',
		 (start_options & K_USER) ? 'u' : 'k');
	snprintf(description, sizeof(description),
		 "%-40s - Wait for all events (w/ ctx switch)", tag);
	cycles = timestamp.cycles;
	PRINT_STATS_AVG(description, (uint32_t)cycles,
			num_iterations, false, "");
	skadi_benchmark_evaluate_samples(event_samples_7, CONFIG_BENCHMARK_NUM_ITERATIONS, 0, description);
#ifdef SKADI_SUBSYSTEM
	skadi_sem_give(&pause_sem);
#else
	k_sem_give(&pause_sem);
#endif

	snprintf(tag, sizeof(tag),
		 "events.post.wake+ctx.%c_to_%c",
		 (start_options & K_USER) ? 'u' : 'k',
		 (alt_options & K_USER) ? 'u' : 'k');
	snprintf(description, sizeof(description),
		 "%-40s - Post events (w/ ctx switch)", tag);
	cycles = timestamp.cycles;
	PRINT_STATS_AVG(description, (uint32_t)cycles,
			num_iterations, false, "");
	skadi_benchmark_evaluate_samples(event_samples_8, CONFIG_BENCHMARK_NUM_ITERATIONS, 0, description);

#ifdef SKADI_SUBSYSTEM
	skadi_thread_join(&start_thread, K_FOREVER);
	skadi_thread_cleanup(&start_thread);
#else
	k_thread_join(&start_thread, K_FOREVER);
#endif

	timing_stop();

	return 0;
}
```

## src/fifo.c
```c
/*
 * Copyright (c) 2024 Intel Corporation
 *
 * SPDX-License-Identifier: Apache-2.0
 */

/*
 * @file measure time for various FIFO operations
 *
 * This file contains the tests that measures the times for the following
 * FIFO operations from both kernel threads and user threads:
 *  1. Immediately adding a data item to a FIFO
 *  2. Immediately removing a data item from a FIFO
 *  3. Immediately adding a data item to a FIFO with allocation
 *  4. Immediately removing a data item from a FIFO with allocation
 *  5. Blocking on removing a data item from a FIFO
 *  6. Waking (and context switching to) a thread blocked on a FIFO via
 *     k_fifo_put().
 *  7. Waking (and context switching to) a thread blocked on a FIFO via
 *     k_fifo_alloc_put().
 */

#include <zephyr/kernel.h>
#include <zephyr/timing/timing.h>
#include "utils.h"
#include "timing_sc.h"

#ifdef SKADI_SUBSYSTEM
#include <zephyr/skadi/skadi_subsystem.h>
#include <zephyr/skadi/skadi_sched.h>
#include <zephyr/skadi/skadi_queue.h>
#endif

#define STACK_SIZE (512 + CONFIG_TEST_EXTRA_STACK_SIZE)

#ifdef SKADI_SUBSYSTEM
static struct k_fifo fifo;
#else
static K_FIFO_DEFINE(fifo);
#endif

BENCH_BMEM uintptr_t fifo_data[5];

static struct skadi_benchmark_state fifo_samples_1[CONFIG_BENCHMARK_NUM_ITERATIONS],
			   fifo_samples_2[CONFIG_BENCHMARK_NUM_ITERATIONS],
			   fifo_samples_3[CONFIG_BENCHMARK_NUM_ITERATIONS],
			   fifo_samples_4[CONFIG_BENCHMARK_NUM_ITERATIONS],
			   fifo_samples_5[CONFIG_BENCHMARK_NUM_ITERATIONS],
			   fifo_samples_6[CONFIG_BENCHMARK_NUM_ITERATIONS],
			   fifo_samples_7[CONFIG_BENCHMARK_NUM_ITERATIONS],
			   fifo_samples_8[CONFIG_BENCHMARK_NUM_ITERATIONS];

#ifdef SKADI_SUBSYSTEM
SKADI_SUBSYSTEM_CALLEE_TRAMPOLINE(void, fifo_put_get_thread_entry, void *p1, void *p2, void *p3)
#else
static void fifo_put_get_thread_entry(void *p1, void *p2, void *p3)
#endif
{
	uint32_t num_iterations = (uint32_t)(uintptr_t)p1;
	uint32_t options = (uint32_t)(uintptr_t)p2;
	timing_t start;
	timing_t mid;
	timing_t finish;
	uint64_t put_sum = 0ULL;
	uint64_t get_sum = 0ULL;
	uintptr_t *data;

	if ((options & K_USER) == 0) {
		for (uint32_t i = 0; i < num_iterations; i++) {
			skadi_benchmark_prepare_sample(&fifo_samples_1[i]);
			skadi_benchmark_prepare_sample(&fifo_samples_2[i]);
			start = timing_timestamp_get();

#ifdef SKADI_SUBSYSTEM
			skadi_fifo_put(&fifo, fifo_data);
#else
			k_fifo_put(&fifo, fifo_data);
#endif

			mid = timing_timestamp_get();

#ifdef SKADI_SUBSYSTEM
			data = skadi_fifo_get(&fifo, K_NO_WAIT);
#else
			data = k_fifo_get(&fifo, K_NO_WAIT);
#endif

			finish = timing_timestamp_get();

			put_sum += timing_cycles_get(&start, &mid);
			get_sum += timing_cycles_get(&mid, &finish);
			skadi_benchmark_add_sample(&fifo_samples_1[i], timing_cycles_to_ns(timing_cycles_get(&start, &mid)));
			skadi_benchmark_add_sample(&fifo_samples_2[i], timing_cycles_to_ns(timing_cycles_get(&mid, &finish)));
		}

		timestamp.cycles = put_sum;
#ifdef SKADI_SUBSYSTEM
		skadi_sem_take(&pause_sem, K_FOREVER);
#else
		k_sem_take(&pause_sem, K_FOREVER);
#endif

		timestamp.cycles = get_sum;
#ifdef SKADI_SUBSYSTEM
		skadi_sem_take(&pause_sem, K_FOREVER);
#else
		k_sem_take(&pause_sem, K_FOREVER);
#endif

		put_sum = 0ULL;
		get_sum = 0ULL;
	}

	for (uint32_t i = 0; i < num_iterations; i++) {
		skadi_benchmark_prepare_sample(&fifo_samples_3[i]);
		skadi_benchmark_prepare_sample(&fifo_samples_4[i]);
		start = timing_timestamp_get();

#ifdef SKADI_SUBSYSTEM
		skadi_fifo_alloc_put(&fifo, fifo_data);
#else
		k_fifo_alloc_put(&fifo, fifo_data);
#endif

		mid = timing_timestamp_get();

#ifdef SKADI_SUBSYSTEM
		data = skadi_fifo_get(&fifo, K_NO_WAIT);
#else
		data = k_fifo_get(&fifo, K_NO_WAIT);
#endif

		finish = timing_timestamp_get();

		put_sum += timing_cycles_get(&start, &mid);
		get_sum += timing_cycles_get(&mid, &finish);
		skadi_benchmark_add_sample(&fifo_samples_3[i], timing_cycles_to_ns(timing_cycles_get(&start, &mid)));
		skadi_benchmark_add_sample(&fifo_samples_4[i], timing_cycles_to_ns(timing_cycles_get(&mid, &finish)));
	}

	timestamp.cycles = put_sum;
#ifdef SKADI_SUBSYSTEM
	skadi_sem_take(&pause_sem, K_FOREVER);
#else
	k_sem_take(&pause_sem, K_FOREVER);
#endif

	timestamp.cycles = get_sum;
}
#ifdef SKADI_SUBSYSTEM
SKADI_SUBSYSTEM_CALLEE_TRAMPOLINE_END(fifo_put_get_thread_entry)
#endif

int fifo_ops(uint32_t num_iterations, uint32_t options)
{
	int      priority;
	uint64_t cycles;
	char     tag[50];
	char     description[120];

#ifdef SKADI_SUBSYSTEM
	struct skadi_thread_create_params params;

	skadi_fifo_init(&fifo);

	priority = skadi_thread_priority_get(skadi_current_get());
#else
	priority = k_thread_priority_get(k_current_get());
#endif

	timing_start();

#ifdef SKADI_SUBSYSTEM
	params.new_thread = &start_thread;
	params.stack = start_stack;
	params.stack_size = K_THREAD_STACK_SIZEOF(start_stack);
	params.entry = SKADI_SUBSYSTEM_FUNCTION_POINTER(fifo_put_get_thread_entry);

	params.p1 = (void *)(uintptr_t)num_iterations;
	params.p2 = (void *)(uintptr_t)options;
	params.p3 = NULL;
	params.prio = priority - 1;
	params.options = options;
	params.delay = K_FOREVER;

	skadi_thread_create(&params);
#else

	k_thread_create(&start_thread, start_stack,
			K_THREAD_STACK_SIZEOF(start_stack),
			fifo_put_get_thread_entry,
			(void *)(uintptr_t)num_iterations,
			(void *)(uintptr_t)options, NULL,
			priority - 1, options, K_FOREVER);
#endif

	k_thread_access_grant(&start_thread, &pause_sem, &fifo);

#ifdef SKADI_SUBSYSTEM
	skadi_thread_start(&start_thread);
#else
	k_thread_start(&start_thread);
#endif

	if ((options & K_USER) == 0) {
		snprintf(tag, sizeof(tag),
			 "fifo.put.immediate.%s",
			 options & K_USER ? "user" : "kernel");
		snprintf(description, sizeof(description),
			 "%-40s - Add data to FIFO (no ctx switch)", tag);

		cycles = timestamp.cycles;
		cycles -= timestamp_overhead_adjustment(options, options);
		PRINT_STATS_AVG(description, (uint32_t)cycles,
				num_iterations, false, "");
		skadi_benchmark_evaluate_samples(fifo_samples_1, CONFIG_BENCHMARK_NUM_ITERATIONS, 0, description);
#ifdef SKADI_SUBSYSTEM
		skadi_sem_give(&pause_sem);
#else
		k_sem_give(&pause_sem);
#endif

		snprintf(tag, sizeof(tag),
			 "fifo.get.immediate.%s",
			 options & K_USER ? "user" : "kernel");
		snprintf(description, sizeof(description),
			 "%-40s - Get data from FIFO (no ctx switch)", tag);
		cycles = timestamp.cycles;
		cycles -= timestamp_overhead_adjustment(options, options);
		PRINT_STATS_AVG(description, (uint32_t)cycles,
				num_iterations, false, "");
		skadi_benchmark_evaluate_samples(fifo_samples_2, CONFIG_BENCHMARK_NUM_ITERATIONS, 0, description);
#ifdef SKADI_SUBSYSTEM
		skadi_sem_give(&pause_sem);
#else
		k_sem_give(&pause_sem);
#endif
	}

	snprintf(tag, sizeof(tag),
		 "fifo.put.alloc.immediate.%s",
		 options & K_USER ? "user" : "kernel");
	snprintf(description, sizeof(description),
		 "%-40s - Allocate to add data to FIFO (no ctx switch)", tag);

	cycles = timestamp.cycles;
	PRINT_STATS_AVG(description, (uint32_t)cycles,
			num_iterations, false, "");
	skadi_benchmark_evaluate_samples(fifo_samples_3, CONFIG_BENCHMARK_NUM_ITERATIONS, 0, description);
#ifdef SKADI_SUBSYSTEM
	skadi_sem_give(&pause_sem);
#else
	k_sem_give(&pause_sem);
#endif

	snprintf(tag, sizeof(tag),
		 "fifo.get.free.immediate.%s",
		 options & K_USER ? "user" : "kernel");
	snprintf(description, sizeof(description),
		 "%-40s - Free when getting data from FIFO (no ctx switch)", tag);
	cycles = timestamp.cycles;
	PRINT_STATS_AVG(description, (uint32_t)cycles,
			num_iterations, false, "");
	skadi_benchmark_evaluate_samples(fifo_samples_4, CONFIG_BENCHMARK_NUM_ITERATIONS, 0, description);
#ifdef SKADI_SUBSYSTEM
	skadi_thread_join(&start_thread, K_FOREVER);
	skadi_thread_cleanup(&start_thread);
#else
	k_thread_join(&start_thread, K_FOREVER);
#endif

	timing_stop();

	return 0;
}

#ifdef SKADI_SUBSYSTEM
SKADI_SUBSYSTEM_CALLEE_TRAMPOLINE(void, fifo_alt_thread_entry, void *p1, void *p2, void *p3)
#else
static void fifo_alt_thread_entry(void *p1, void *p2, void *p3)
#endif
{
	uint32_t num_iterations = (uint32_t)(uintptr_t)p1;
	uint32_t options = (uint32_t)(uintptr_t)p2;
	timing_t  start;
	timing_t  mid;
	timing_t  finish;
	uint64_t  sum[4] = {0ULL, 0ULL, 0ULL, 0ULL};
	uintptr_t *data;
	uint32_t  i;

	if ((options & K_USER) == 0) {

		/* Used with k_fifo_put() */

		for (i = 0; i < num_iterations; i++) {
			skadi_benchmark_prepare_sample(&fifo_samples_5[i]);
			skadi_benchmark_prepare_sample(&fifo_samples_6[i]);

			/* 1. Block waiting for data on FIFO */

			start = timing_timestamp_get();
#ifdef SKADI_SUBSYSTEM
			data = skadi_fifo_get(&fifo, K_FOREVER);
#else
			data = k_fifo_get(&fifo, K_FOREVER);
#endif

			/* 3. Data obtained. */

			finish = timing_timestamp_get();

			mid = timestamp.sample;

			sum[0] += timing_cycles_get(&start, &mid);
			sum[1] += timing_cycles_get(&mid, &finish);
			skadi_benchmark_add_sample(&fifo_samples_5[i], timing_cycles_to_ns(timing_cycles_get(&start, &mid)));
			skadi_benchmark_add_sample(&fifo_samples_6[i], timing_cycles_to_ns(timing_cycles_get(&mid, &finish)));
		}
	}

	/* Used with k_fifo_alloc_put() */

	for (i = 0; i < num_iterations; i++) {
		skadi_benchmark_prepare_sample(&fifo_samples_7[i]);
		skadi_benchmark_prepare_sample(&fifo_samples_8[i]);

		/* 4. Block waiting for data on FIFO */

		start = timing_timestamp_get();

#ifdef SKADI_SUBSYSTEM
		data = skadi_fifo_get(&fifo, K_FOREVER);
#else
		data = k_fifo_get(&fifo, K_FOREVER);
#endif

		/* 6. Data obtained */

		finish = timing_timestamp_get();

		mid = timestamp.sample;

		sum[2] += timing_cycles_get(&start, &mid);
		sum[3] += timing_cycles_get(&mid, &finish);
		skadi_benchmark_add_sample(&fifo_samples_7[i], timing_cycles_to_ns(timing_cycles_get(&start, &mid)));
		skadi_benchmark_add_sample(&fifo_samples_8[i], timing_cycles_to_ns(timing_cycles_get(&mid, &finish)));
	}

	if ((options & K_USER) == 0) {
		timestamp.cycles = sum[0];
#ifdef SKADI_SUBSYSTEM
		skadi_sem_take(&pause_sem, K_FOREVER);
#else
		k_sem_take(&pause_sem, K_FOREVER);
#endif
		timestamp.cycles = sum[1];
#ifdef SKADI_SUBSYSTEM
		skadi_sem_take(&pause_sem, K_FOREVER);
#else
		k_sem_take(&pause_sem, K_FOREVER);
#endif
	}

	timestamp.cycles = sum[2];
#ifdef SKADI_SUBSYSTEM
	skadi_sem_take(&pause_sem, K_FOREVER);
#else
	k_sem_take(&pause_sem, K_FOREVER);
#endif
	timestamp.cycles = sum[3];
}
#ifdef SKADI_SUBSYSTEM
SKADI_SUBSYSTEM_CALLEE_TRAMPOLINE_END(fifo_alt_thread_entry)
#endif

#ifdef SKADI_SUBSYSTEM
SKADI_SUBSYSTEM_CALLEE_TRAMPOLINE(void, fifo_start_thread_entry, void *p1, void *p2, void *p3)
#else
static void fifo_start_thread_entry(void *p1, void *p2, void *p3)
#endif
{
	uint32_t num_iterations = (uint32_t)(uintptr_t)p1;
	uint32_t options = (uint32_t)(uintptr_t)p2;
	uint32_t i;
#ifdef SKADI_SUBSYSTEM
	skadi_thread_start(&alt_thread);
#else
	k_thread_start(&alt_thread);
#endif

	if ((options & K_USER) == 0) {
		for (i = 0; i < num_iterations; i++) {

			/* 2. Add data thereby waking alt thread */

			timestamp.sample = timing_timestamp_get();
#ifdef SKADI_SUBSYSTEM
			skadi_fifo_put(&fifo, fifo_data);
#else
			k_fifo_put(&fifo, fifo_data);
#endif

		}
	}

	for (i = 0; i < num_iterations; i++) {

		/* 5. Add data thereby waking alt thread */

		timestamp.sample = timing_timestamp_get();
#ifdef SKADI_SUBSYSTEM
		skadi_fifo_alloc_put(&fifo, fifo_data);
#else
		k_fifo_alloc_put(&fifo, fifo_data);
#endif

	}

#ifdef SKADI_SUBSYSTEM
	skadi_thread_join(&alt_thread, K_FOREVER);
	skadi_thread_cleanup(&alt_thread);
#else
	k_thread_join(&alt_thread, K_FOREVER);
#endif
}
#ifdef SKADI_SUBSYSTEM
SKADI_SUBSYSTEM_CALLEE_TRAMPOLINE_END(fifo_start_thread_entry)
#endif

int fifo_blocking_ops(uint32_t num_iterations, uint32_t start_options,
		      uint32_t alt_options)
{
	int      priority;
	uint64_t cycles;
	char     tag[50];
	char     description[120];

#ifdef SKADI_SUBSYSTEM
	struct skadi_thread_create_params params;

	priority = skadi_thread_priority_get(skadi_current_get());
#else
	priority = k_thread_priority_get(k_current_get());
#endif

	timing_start();

#ifdef SKADI_SUBSYSTEM
	params.new_thread = &start_thread;
	params.stack = start_stack;
	params.stack_size = K_THREAD_STACK_SIZEOF(start_stack);
	params.entry = SKADI_SUBSYSTEM_FUNCTION_POINTER(fifo_start_thread_entry);

	params.p1 = (void *)(uintptr_t)num_iterations;
	params.p2 = (void *)(uintptr_t)(start_options | alt_options);
	params.p3 = NULL;
	params.prio = priority - 1;
	params.options = start_options;
	params.delay = K_FOREVER;

	skadi_thread_create(&params);

	params.new_thread = &alt_thread;
	params.stack = alt_stack;
	params.stack_size = K_THREAD_STACK_SIZEOF(alt_stack);
	params.entry = SKADI_SUBSYSTEM_FUNCTION_POINTER(fifo_alt_thread_entry);

	params.prio = priority - 2;
	params.options = alt_options;

	skadi_thread_create(&params);
#else

	k_thread_create(&start_thread, start_stack,
			K_THREAD_STACK_SIZEOF(start_stack),
			fifo_start_thread_entry,
			(void *)(uintptr_t)num_iterations,
			(void *)(uintptr_t)(start_options | alt_options), NULL,
			priority - 1, start_options, K_FOREVER);

	k_thread_create(&alt_thread, alt_stack,
			K_THREAD_STACK_SIZEOF(alt_stack),
			fifo_alt_thread_entry,
			(void *)(uintptr_t)num_iterations,
			(void *)(uintptr_t)(start_options | alt_options), NULL,
			priority - 2, alt_options, K_FOREVER);
#endif

	k_thread_access_grant(&start_thread, &alt_thread, &pause_sem, &fifo);
	k_thread_access_grant(&alt_thread, &pause_sem, &fifo);

#ifdef SKADI_SUBSYSTEM
	skadi_thread_start(&start_thread);
#else
	k_thread_start(&start_thread);
#endif

	if (((start_options | alt_options) & K_USER) == 0) {
		snprintf(tag, sizeof(tag),
			 "fifo.get.blocking.%s_to_%s",
			 alt_options & K_USER ? "u" : "k",
			 start_options & K_USER ? "u" : "k");
		snprintf(description, sizeof(description),
			 "%-40s - Get data from FIFO (w/ ctx switch)", tag);

		cycles = timestamp.cycles;
		PRINT_STATS_AVG(description, (uint32_t)cycles,
				num_iterations, false, "");
		skadi_benchmark_evaluate_samples(fifo_samples_5, CONFIG_BENCHMARK_NUM_ITERATIONS, 0, description);
#ifdef SKADI_SUBSYSTEM
		skadi_sem_give(&pause_sem);
#else
		k_sem_give(&pause_sem);
#endif

		snprintf(tag, sizeof(tag),
			 "fifo.put.wake+ctx.%s_to_%s",
			 start_options & K_USER ? "u" : "k",
			 alt_options & K_USER ? "u" : "k");
		snprintf(description, sizeof(description),
			 "%-40s - Add data to FIFO (w/ ctx switch)", tag);
		cycles = timestamp.cycles;
		PRINT_STATS_AVG(description, (uint32_t)cycles,
				num_iterations, false, "");
		skadi_benchmark_evaluate_samples(fifo_samples_6, CONFIG_BENCHMARK_NUM_ITERATIONS, 0, description);
#ifdef SKADI_SUBSYSTEM
		skadi_sem_give(&pause_sem);
#else
		k_sem_give(&pause_sem);
#endif
	}

	snprintf(tag, sizeof(tag),
		 "fifo.get.free.blocking.%s_to_%s",
		 alt_options & K_USER ? "u" : "k",
		 start_options & K_USER ? "u" : "k");
	snprintf(description, sizeof(description),
		 "%-40s - Free when getting data from FIFO (w/ ctx siwtch)", tag);

	cycles = timestamp.cycles;
	PRINT_STATS_AVG(description, (uint32_t)cycles,
			num_iterations, false, "");
	skadi_benchmark_evaluate_samples(fifo_samples_7, CONFIG_BENCHMARK_NUM_ITERATIONS, 0, description);
#ifdef SKADI_SUBSYSTEM
	skadi_sem_give(&pause_sem);
#else
	k_sem_give(&pause_sem);
#endif

	snprintf(tag, sizeof(tag),
		 "fifo.put.alloc.wake+ctx.%s_to_%s",
		 start_options & K_USER ? "u" : "k",
		 alt_options & K_USER ? "u" : "k");
	snprintf(description, sizeof(description),
		 "%-40s - Allocate to add data to FIFO (w/ ctx switch)", tag);
	cycles = timestamp.cycles;
	PRINT_STATS_AVG(description, (uint32_t)cycles,
			num_iterations, false, "");
	skadi_benchmark_evaluate_samples(fifo_samples_8, CONFIG_BENCHMARK_NUM_ITERATIONS, 0, description);

#ifdef SKADI_SUBSYSTEM
	skadi_thread_join(&start_thread, K_FOREVER);
	skadi_thread_cleanup(&start_thread);
#else
	k_thread_join(&start_thread, K_FOREVER);
#endif

	timing_stop();

	return 0;
}
```
