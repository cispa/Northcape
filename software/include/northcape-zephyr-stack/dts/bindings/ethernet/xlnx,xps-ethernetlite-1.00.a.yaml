## software/include/northcape-zephyr-stack/dts/bindings/ethernet/xlnx,xps-ethernetlite-1.00.a.yaml
```yaml
# 
# SPDX-License-Identifier: Apache-2.0

description: Xilinx AXI Ethernet Lite subsystem (MAC and MDIO) bindings.

# only "reg" property is used
include: [base.yaml]

compatible: "xlnx,xps-ethernetlite-1.00.a"
```

## software/include/northcape-zephyr-stack/dts/bindings/timer/pulp,apb-timer.yaml
```yaml
# 
# SPDX-License-Identifier: Apache-2.0

description: |
  Xilinx AXI DMA LogiCORE IP controller with compatibility string
  generated in use with the AXI Ethernet subsystem.

include: base.yaml

# this is the compatible generated by Vitis for the AXI Ethernet subsystem
compatible: "pulp,apb_timer"

properties:
  reg:
    required: true

  interrupts:
    type: array
    description: Pairs of IRQ number for overflow and match
    required: true

  interrupt-parent:
    type: phandle
    description: Interrupt controller that the timer is connected to

  pulp,clock-period-ns:
    type: int
    description: Timer clock period in ns
    required: true
```
