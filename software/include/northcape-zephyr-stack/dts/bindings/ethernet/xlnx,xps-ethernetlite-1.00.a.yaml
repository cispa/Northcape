## software/include/northcape-zephyr-stack/soc/openhwgroup/cv64a6/Kconfig
```kconfig
# Copyright (c) 2024 Nordic Semiconductor ASA
# SPDX-License-Identifier: Apache-2.0

if SOC_FAMILY_ARIANE_CV64A6

rsource "*/Kconfig"

endif # SOC_FAMILY_ARIANE_CV64A6
```

## software/include/northcape-zephyr-stack/soc/openhwgroup/cv64a6/Kconfig.defconfig
```kconfig
# Copyright (c) 2024 Nordic Semiconductor ASA
# SPDX-License-Identifier: Apache-2.0

if SOC_FAMILY_ARIANE_CV64A6

rsource "*/Kconfig.defconfig"

# Copyright (c) 2020-2021 Microchip Technology Inc
# SPDX-License-Identifier: Apache-2.0

if SOC_SERIES_CV64A6

# MPFS should be configured so that the mtimer clock is 1MHz independent of the CPU clock...

config SYS_CLOCK_HW_CYCLES_PER_SEC
	default 25000000

config RISCV_SOC_INTERRUPT_INIT
	default y

config RISCV_GP
	default y

config 2ND_LVL_ISR_TBL_OFFSET
	default 13

config 2ND_LVL_INTR_00_OFFSET
	default 11

config MAX_IRQ_PER_AGGREGATOR
	default 186

config NUM_IRQS
	default 186

endif # SOC_SERIES_CV64A6


endif # SOC_FAMILY_ARIANE_CV64A6
```

## software/include/northcape-zephyr-stack/soc/openhwgroup/cv64a6/Kconfig.soc
```kconfig
config SOC_FAMILY_ARIANE_CV64A6
	bool

config SOC_FAMILY
	default "ariane_cv64a6" if SOC_FAMILY_ARIANE_CV64A6

rsource "*/Kconfig.soc"
```

## software/include/northcape-zephyr-stack/soc/openhwgroup/cv64a6/cv64a6/Kconfig
```kconfig
# RISCV64 Ariane cva6 configuration options

config SOC_SERIES_CV64A6
	select RISCV

config SOC_SERIES_CV64A6_HAS_PLIC
	bool "Is PLIC available?"
	depends on SOC_SERIES_CV64A6
	select RISCV_HAS_PLIC
	default y
	help
		In the Skadi system, the PLIC is separated out into a separate driver task.
		Thus, it is not available until the driver task has been loaded.
		The system has to disable the interrupt registers to disable interrupts.

config SOC_SERIES_CV64A6_HAS_CMO
	bool "Are CMO enabled?"
	depends on SOC_SERIES_CV64A6
	help
		Are cache management operations (CMOs) available?
		Currently, CMOs are only supported with the HPDCache.

config SOC_CV64A6
	select RISCV_PRIVILEGED
	select ATOMIC_OPERATIONS_BUILTIN
	# for transition period, where subsystems call into main binary, this is a problem:
	# the GP is destroyed by jump into subsystem.
	# select RISCV_GP
	select USE_SWITCH_SUPPORTED
	select USE_SWITCH
	select CPU_HAS_FPU
	select CPU_HAS_FPU_DOUBLE_PRECISION
	select SCHED_IPI_SUPPORTED
	select 64BIT
	select RISCV_ISA_RV64I
	select RISCV_ISA_EXT_M
	select RISCV_ISA_EXT_A
	select RISCV_ISA_EXT_C
	select RISCV_ISA_EXT_ZICSR
	select RISCV_ISA_EXT_ZIFENCEI
	select RISCV_ISA_EXT_ZBA
	select RISCV_ISA_EXT_ZBB
	select RISCV_ISA_EXT_ZBC
	select RISCV_ISA_EXT_ZBS
	select HAS_POWEROFF
	select CPU_HAS_DCACHE
	select CPU_HAS_ICACHE

config SOC_CV64A6_IMAC
	select RISCV_PRIVILEGED
	select ATOMIC_OPERATIONS_BUILTIN
	# for transition period, where subsystems call into main binary, this is a problem:
	# the GP is destroyed by jump into subsystem.
	# select RISCV_GP
	select USE_SWITCH_SUPPORTED
	select USE_SWITCH
	select SCHED_IPI_SUPPORTED
	select 64BIT
	select RISCV_ISA_RV64I
	select RISCV_ISA_EXT_M
	select RISCV_ISA_EXT_A
	select RISCV_ISA_EXT_C
	select RISCV_ISA_EXT_ZICSR
	select RISCV_ISA_EXT_ZIFENCEI
	select RISCV_ISA_EXT_ZBA
	select RISCV_ISA_EXT_ZBB
	select RISCV_ISA_EXT_ZBC
	select RISCV_ISA_EXT_ZBS
	select HAS_POWEROFF
	select CPU_HAS_DCACHE
	select CPU_HAS_ICACHE


config SOC_SERIES_CV64A6_PROVIDE_NONSTANDARD_CACHE_OPTIONS
	bool "Include non-standard cache management operations"
	depends on SOC_CV64A6 || SOC_CV64A6_IMAC
	default n

config SOC_SERIES_CV64A6_PROVIDE_TEST_POWEROFF
	bool "Include methods for terminating a test in the CV64a6 testbench"
	depends on SOC_CV64A6 || SOC_CV64a6_IMAC
	default n

config SOC_SERIES_CV64A6_PROVIDE_FPGA_POWEROFF
	bool "Include methods for terminating a test on the FPGA"
	depends on SOC_CV64A6 || SOC_CV64A6_IMAC
	default n
```

## software/include/northcape-zephyr-stack/soc/openhwgroup/cv64a6/cv64a6/Kconfig.soc
```kconfig
config SOC_SERIES_CV64A6
	bool
	select SOC_FAMILY_ARIANE_CV64A6
	help
	  Ariane cva64 cores without skadi support

config SOC_CV64A6_IMAC
	bool
	select SOC_SERIES_CV64A6
	help
	  Microchip MPFS system implementation
config SOC_CV64A6
	bool
	select SOC_SERIES_CV64A6
	help
	  Microchip MPFS system implementation

config SOC_SERIES
	default "cv64a6" if SOC_SERIES_CV64A6

config SOC
	default "cv64a6" if SOC_CV64A6
	default "cv64a6" if SOC_CV64A6_IMAC
```

## software/include/northcape-zephyr-stack/subsys/skadi/Kconfig
```kconfig
source "subsys/skadi/allocator/Kconfig.skadi_alloc"
source "subsys/skadi/library/Kconfig.skadi_library"
source "subsys/skadi/libc/Kconfig"
```

## software/include/northcape-zephyr-stack/subsys/skadi/allocator/Kconfig.skadi_alloc
```kconfig
if SKADI_LOADER
choice SKADI_ALLOCATOR_ALLOCATION_STRATEGY
    prompt "Skadi allocator allocation strategy"
    default SKADI_ALLOCATOR_FIRST_FIT
    help
        Select allocation strategy for skadi allocator.

config SKADI_ALLOCATOR_FIRST_FIT
    bool "First fit allocation"
    help
        Allocate using first-fit from size-sorted RBtree.

config SKADI_ALLOCATOR_BEST_FIT
    bool "Best fit allocation"
    help
        Allocate using best-fit from size-sorted RBtree.

endchoice

config SKADI_ALLOCATOR_DEBUG
    bool "Debug the allocator"
    depends on SKADI_DEBUG
    help
        Do not task-id-restrict the allocator chunks.

endif
```

## software/include/northcape-zephyr-stack/subsys/skadi/libc/Kconfig
```kconfig
config SKADI_LIBC_SUPPORTS_FPU
    bool "Skadi library has support for floating-point operation"
    depends on SKADI_LOADER
    help
        Select y if you need the FPU to be activated in the libc, e.g., when calling printf() and friends with floating-point arguments.
```

## software/include/northcape-zephyr-stack/subsys/skadi/library/Kconfig.skadi_library
```kconfig
config SKADI_LIBRARY_LOCAL_ALLOCATOR
    bool "Provide per-subsystem allocator that bypasses system allocator"
    default y if SKADI_LOADER
    help
        Provide per-subsystem allocator. This is used for all allocations up to 
        SKADI_LIBRARY_LOCAL_ALLOCATOR_CHUNK_SIZE.
        The local allocator avoids a costly subsystem call into the system allocator.
        The allocation strategy is as follows:
        The allocator holds an array of SKADI_LIBRARY_LOCAL_ALLOCATOR_NUM_CHUNKS
        chunks (as a backing store) and tracks their allocation using an atomic bitmap.
        On each allocation request, IF the request size is below the threshold,
        the local allocator looks for a free chunk in the atomic bitmap.
        If such a chunk exists, it is utilized for the allocation request.
        Similarly, on each free, the local allocator checks if the freed memory is
        within the bounds of its array. If it is, it frees it locally.

if SKADI_LIBRARY_LOCAL_ALLOCATOR

config SKADI_LIBRARY_LOCAL_ALLOCATOR_CHUNK_SIZE
    int "Size of each local allocator chunk"
    default 64
    help
        This value controls the size of each local allocator chunk.


config SKADI_LIBRARY_LOCAL_ALLOCATOR_NUM_CHUNKS
    int "Number of allocator chunks"
    default 128
    help
        This value controls the number of local allocator chunks.
endif

config SKADI_LIBRARY_LOCAL_CLOCK
    bool "Local per-subsystem clock driver"
    help
        If enabled, every subsystem provides its own clock driver.
        To this end, it requests a read-only capability for the MTIME register
        and accesses it.

config SKADI_LIBRARY_PRINTF_STRING_BYTES_OUT_SUPPORT
    bool "Support for %s, %n modifiers for printf"
    help
        If enabled, allows you to use %s and %n modifiers for printf() in subsystems.
```

## software/include/northcape-zephyr-stack/tests/benchmarks/northcape-stream/Kconfig
```kconfig
mainmenu "Stream config"

config STREAM_ARRAY_SIZE
    int "Stream benchmark array size"
    default 10000000
    help
        Stream array size. See stream documentation.

source "Kconfig.zephyr"
```
