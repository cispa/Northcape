## CMakeLists.txt
```
# SPDX-License-Identifier: Apache-2.0

cmake_minimum_required(VERSION 3.20.0)

find_package(Zephyr REQUIRED HINTS $ENV{ZEPHYR_BASE})
project(hello_world)

if(CONFIG_SKADI_OS)
    create_skadi_subsystem_main(APP app SRCS src/main.c)
else()
    target_sources(app PRIVATE src/main.c)
endif()
```

## prj.conf
```kconfig
# unneeded subsystems
CONFIG_NETWORKING=n
CONFIG_DMA=n
CONFIG_PULP_APB_TIMER=n

# size optimization
CONFIG_SKADI_SUBSYSTEM_STACK_SIZE=1023
CONFIG_SKADI_SUBSYSTEM_CALLER_TRAMPOLINE_NUM_REGISTER_SETS=4
CONFIG_SKADI_SUBSYSTEM_CALLEE_TRAMPOLINE_NUM_STACKS=4
CONFIG_SKADI_ISR_STACK_SIZE=1024
CONFIG_SKADI_DEBUG_MODULE_DRIVER=n
CONFIG_SKADI_LIBC_INLINE=n
CONFIG_SKADI_TEXT_ALIGN_12_BIT=n
CONFIG_SKADI_LIBRARY_LOCAL_ALLOCATOR=n
CONFIG_SKADI_LIBRARY_LOCAL_CLOCK=n
CONFIG_SKADI_EARLYCON=n
CONFIG_SKADI_SUBSYS_SYNC_ATOMIC=y
```

## src/main.c
```c
/*
 * Copyright (c) 2012-2014 Wind River Systems, Inc.
 *
 * SPDX-License-Identifier: Apache-2.0
 */

#include <stdio.h>
#ifdef SKADI_SUBSYSTEM
#include <zephyr/skadi/skadi_subsystem.h>
#endif
#include <zephyr/skadi/skadi_benchmark.h>


#ifdef SKADI_SUBSYSTEM
SKADI_SUBSYSTEM_MAIN(void)
#else
int main(void)
#endif
{
	skadi_evaluate_boot_time();
	printf("Hello World! %s\n", CONFIG_BOARD_TARGET);

	return 0;
}
#ifdef SKADI_SUBSYSTEM
SKADI_SUBSYSTEM_MAIN_END
#endif
```
