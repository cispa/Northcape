## prj.conf
```kconfig
CONFIG_USERSPACE=y
CONFIG_ASSERT=y
CONFIG_LOG=y
CONFIG_LOG_MODE_MINIMAL=y
CONFIG_MAIN_STACK_SIZE=2048
CONFIG_COMMON_LIBC_MALLOC_ARENA_SIZE=0
# do not distract us plz
CONFIG_NETWORKING=n
# TODO should not be here, but convenient place to put it
CONFIG_RISCV_PMP=y
CONFIG_KOBJECT_TEXT_AREA=1024
CONFIG_APPLICATION_DEFINED_SYSCALL=y
```

## src/main.c
```c
/*
 * Copyright (c) 2020 BayLibre, SAS
 *
 * SPDX-License-Identifier: Apache-2.0
 */

#include <zephyr/kernel.h>
#include <zephyr/internal/syscall_handler.h>
#include <stdio.h>

#include "thread_def.h"

#include <cv64a6.h>

void z_impl_k_current_cycle_instr_get(unsigned long *cycle_half, unsigned long *instr_half){
	*instr_half = csr_read(0xC02);
	*cycle_half = csr_read(0xC00);
}

static inline void z_vrfy_k_current_cycle_instr_get(unsigned long *cycle_half, unsigned long *instr_half){
	K_OOPS(K_SYSCALL_MEMORY_WRITE(cycle_half, sizeof(*cycle_half)));
	K_OOPS(K_SYSCALL_MEMORY_WRITE(instr_half, sizeof(*instr_half)));
	z_impl_k_current_cycle_instr_get(cycle_half, instr_half);
}
#include <zephyr/syscalls/k_current_cycle_instr_get_mrsh.c>


int main(void)
{
	printf("Main Thread started; %s\n", CONFIG_BOARD);
	/* enable performance counters */
	csr_set(mcounteren, 0x1 | (0x1 << 2));
	csr_set(scounteren, 0x1 | (0x1 << 2));

	/* TODO do not want this to be runnable */
	/*
	k_thread_create(&supervisor_thread, supervisor_stack, THREAD_STACKSIZE,
			supervisor_thread_function, NULL, NULL, NULL,
			-1, K_INHERIT_PERMS, K_NO_WAIT);

	k_sleep(K_MSEC(1000));
	*/

	k_thread_create(&user_thread, user_stack, THREAD_STACKSIZE,
			user_thread_function, NULL, NULL, NULL,
			-1, K_USER | K_INHERIT_PERMS, K_NO_WAIT);

	k_thread_join(&user_thread, K_FOREVER);
	z_cv64a6_finish_test(0);

	return 0;
}
```

## src/skadi_benchmark_syscall.h
```c
#include <zephyr/kernel.h>
#include <zephyr/internal/syscall_handler.h>
#ifndef _SKADI_BENCHMARK_SYSCALL_H
#define _SKADI_BENCHMARK_SYSCALL_H

__syscall void k_current_cycle_instr_get(unsigned long *cycle_half, unsigned long *instr_half);

#include <zephyr/syscalls/skadi_benchmark_syscall.h>
#endif
```

## src/test_user.c
```c
/*
 * Copyright (c) 2020 BayLibre, SAS
 *
 * SPDX-License-Identifier: Apache-2.0
 */

#include <zephyr/kernel.h>
#include <stdio.h>

#include <zephyr/skadi/skadi_benchmark.h>
#include "skadi_benchmark_syscall.h"

#define REPETITIONS 100

/*
 * 0xC00 is CSR cycle
 * 0xC02 is CSR instret
 */
void user_thread_function(void *p1, void *p2, void *p3)
{
	register unsigned long cycle_before, cycle_count;
	register unsigned long inst_before, inst_count;
	unsigned long half_cycle, half_instr;

	struct skadi_benchmark_state benchmarks_cycles[REPETITIONS], half_benchmark_cycles[REPETITIONS];

	printf("User thread started\n");

	for(int i = 0; i < REPETITIONS; i++) {
		k_sleep(K_MSEC(100));

		skadi_benchmark_prepare_sample(&benchmarks_cycles[i]);
		skadi_benchmark_prepare_sample(&half_benchmark_cycles[i]);

		inst_before = csr_read(0xC02);
		cycle_before = csr_read(0xC00);
		k_current_cycle_instr_get(&half_cycle, &half_instr);
		cycle_count = csr_read(0xC00);
		inst_count = csr_read(0xC02);

		if (cycle_count > cycle_before) {
			cycle_count -= cycle_before;
		} else {
			cycle_count += 0xFFFFFFFF - cycle_before;
		}

		if (inst_count > inst_before) {
			inst_count -= inst_before;
		} else {
			inst_count += 0xFFFFFFFF - inst_before;
		}

		/* Remove CSR accesses to be more accurate */
		inst_count -= 3;

		skadi_benchmark_add_sample(&benchmarks_cycles[i], cycle_count);
		skadi_benchmark_add_sample(&half_benchmark_cycles[i], half_cycle - cycle_before);

		printf("User thread(%p):\t\t%8lu cycles\t%8lu instructions (half)\t%8lu instructions (full)\n",
			k_current_get(), cycle_count, half_instr - inst_before - 3, inst_count);
	}

	skadi_benchmark_evaluate_samples(half_benchmark_cycles, REPETITIONS, 0, "cycles microbenchmarks (half)");
	skadi_benchmark_evaluate_samples(benchmarks_cycles, REPETITIONS, 0, "cycles microbenchmarks (full)");
}
```

## src/thread_def.h
```c
/*
 * Copyright (c) 2020 BayLibre, SAS
 *
 * SPDX-License-Identifier: Apache-2.0
 */

#ifndef THREAD_DEF_H
#define THREAD_DEF_H

#include <zephyr/kernel.h>

#define THREAD_STACKSIZE	16384

struct k_thread user_thread;
K_THREAD_STACK_DEFINE(user_stack, THREAD_STACKSIZE);
void supervisor_thread_function(void *p1, void *p2, void *p3);

struct k_thread supervisor_thread;
K_THREAD_STACK_DEFINE(supervisor_stack, THREAD_STACKSIZE);
void user_thread_function(void *p1, void *p2, void *p3);

#endif /* THREAD_DEF_H */
```
