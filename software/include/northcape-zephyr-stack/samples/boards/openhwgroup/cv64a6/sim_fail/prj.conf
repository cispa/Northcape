## CMakeLists.txt
```
# SPDX-License-Identifier: Apache-2.0

cmake_minimum_required(VERSION 3.20.0)

find_package(Zephyr REQUIRED HINTS $ENV{ZEPHYR_BASE})
project(cv64a6_sim_fail)

create_skadi_subsystem_main(APP app SRCS src/main.c)
```

## prj.conf
```kconfig
CONFIG_SKADI_SUBSYSTEM_PROVIDES_MAIN=y
```

## src/main.c
```c
/*
 * Copyright (c) 2012-2014 Wind River Systems, Inc.
 *
 * SPDX-License-Identifier: Apache-2.0
 */
#include <cv64a6.h>
#include <stdio.h>

#include <zephyr/skadi/skadi_subsystem.h>



SKADI_SUBSYSTEM_MAIN(void)
{
	printf("I'm a goner! %s\n", CONFIG_BOARD_TARGET);

	z_cv64a6_finish_test(0xdead);

	return 0;
}
SKADI_SUBSYSTEM_MAIN_END
```
