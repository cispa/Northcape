## CMakeLists.txt
```
# SPDX-License-Identifier: Apache-2.0

cmake_minimum_required(VERSION 3.20.0)

find_package(Zephyr REQUIRED HINTS $ENV{ZEPHYR_BASE})
project(capability_test_cv64a6_sim)

target_sources(app PRIVATE src/main.c)
```

## prj.conf
```kconfig
# loader not necessary
CONFIG_SKADI_LOADER=n
CONFIG_SKADI_EXPECTED_EXCEPTION=y
```

## src/main.c
```c
/*
 * 
 *
 * SPDX-License-Identifier: Apache-2.0
 */
#include <cv64a6.h>
#include <stdio.h>
#include <stdint.h>
#include <inttypes.h>

#include <zephyr/skadi/skadi_ariane_genesysii.h>
#include <zephyr/skadi/skadi_allocator.h>
#include <zephyr/skadi/skadi_ops_driver.h>

#include <zephyr/random/random.h>

#include <zephyr/logging/log.h>

LOG_MODULE_REGISTER(skadi_capability_test, CONFIG_LOG_DEFAULT_LEVEL);

int main(void)
{
	const volatile char *invalid_token = (const volatile char *) 0xffffffffffffffff;
	char read;

	/* invalid read - should trigger exception */
	read = *invalid_token;
	
	
	LOG_INF("Test FAIL - expected exception but read %c\n",read);

	z_cv64a6_finish_test(1);

	return 0;
}
```
