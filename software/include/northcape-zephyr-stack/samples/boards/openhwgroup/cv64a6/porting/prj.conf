## CMakeLists.txt
```
# SPDX-License-Identifier: Apache-2.0

cmake_minimum_required(VERSION 3.20.0)

find_package(Zephyr REQUIRED HINTS $ENV{ZEPHYR_BASE})
project(subsystem_sample)

create_skadi_subsystem_main(APP app SRCS src/main.c)

create_skadi_subsystem_custom_sources(EXT_NAME subsystem APP app SRCS src/subsystem.c)
```

## prj.conf
```kconfig
CONFIG_SKADI_SUBSYSTEM_PROVIDES_MAIN=y
CONFIG_SPEED_OPTIMIZATIONS=y
```

## src/main.c
```c
/*
 * 
 *
 * SPDX-License-Identifier: Apache-2.0
 */
#include <stdio.h>


#include <zephyr/skadi/skadi_subsystem.h>
#include "subsystem.h"

const struct dummy_subsystem_parameter capability_param = {
	.foo = 0x42,
	.bar = 0x21
};

#define SCALAR_PARAM 0x1

SKADI_SUBSYSTEM_MAIN(void)
{	
	int ret;

	printf("Hello World from Skadi main subsystem (task ID %d)!\n",SKADI_CURRENT_TASK_ID);
	printf("Calling subsystem with scalar parameter %d capability parameter {foo: %d, bar: %d}!\n", SCALAR_PARAM, capability_param.foo, capability_param.bar);

	/* 
	 * wrapper makes this look like a normal function call
	 */
	ret = subsystem_call(SCALAR_PARAM, &capability_param);

	printf("Subsystem call status: %d!\n", ret);

	return ret;
}
SKADI_SUBSYSTEM_MAIN_END

/*
 * Called in same order as it would be for zephyr, starting after last subsystem was loaded.
 */
static int dummy_init_fn(void){
	printf("UART console has been initialized, so you should see this text. HI!\n");
	
	return 0;
}
SYS_INIT(dummy_init_fn, POST_KERNEL, 0);
```

## src/subsystem.c
```c
/**
 * @file Provides a subsystem that can be used to compute a one-time pad encryption of a uint64_t.
 */
#include <stdio.h>

#include <zephyr/skadi/skadi_subsystem.h>

#include "subsystem.h"

static bool initialized = false;

/*
 * Actual implementation of subsystem call.
 * Convention: Logic is contained in a normal C function, which can be called through subsystem call or from the subsystem. 
 */
int subsystem_call_impl(int scalar, const struct dummy_subsystem_parameter *param){
    printf("Hello world from the subsystem (Task ID %d) was initialized: %d\n", SKADI_CURRENT_TASK_ID, initialized);
    /*
     * arguments work as they should
     */
    printf("Scalar parameter was: %d\ncapability-conveyed struct was {foo: %d, bar: %d}\n",scalar, param->foo, param->bar);

    return 0;
}

SKADI_SUBSYSTEM_CALLEE_TRAMPOLINE(int, __subsystem_call, int scalar, const struct dummy_subsystem_parameter *param)
    return subsystem_call_impl(scalar, param);
SKADI_SUBSYSTEM_CALLEE_TRAMPOLINE_END(__subsystem_call)

/*
 * Called immediately when the subsystem is loaded. 
 */
static bool dummy_init_function(void){
    printf("This text will be printed via the early console in the loader!\n");

    initialized = true;

    return true;
}
SKADI_SUBSYSTEM_INIT_FUNCTIONS(dummy_init_function);
```

## src/subsystem.h
```c
#ifndef _SUBSYSTEM_H
#define _SUBSYSTEM_H

/*
 * Typical Skadi subsystem header.
 * Defines caller trampolines.
 */

#include <zephyr/skadi/skadi_subsystem.h>

struct dummy_subsystem_parameter {
    int foo;
    int bar;
};

/*
 * Subsystem call declaration.
 * Will create a caller trampoline for a subsystem call with the provided name and signature.
 * This can be called as a regular C function.
 */
SKADI_SUBSYSTEM_CALLER_TRAMPOLINE(int, __subsystem_call, int scalar, const struct dummy_subsystem_parameter *param);

/*
 * Skadi convention: subsystem calls have wrappers that are inline functions.
 * Wrappers can be used to, e.g., derive capabilities for function pointer arguments.
 */
static inline int subsystem_call(int scalar, const struct dummy_subsystem_parameter *param){
    int ret;
    /*
     * Cannot (generally) pass a capability token that *we* have access to to the subsystem. Might be, e.g., in our private data segment!
     * Solution: *derive* a capability for the data we want to pass and drop it when we are done
     * Convenience function creates a capability with the offset corresponding to the parameter, the size of the structure and read-only permissions.
     */
    const struct dummy_subsystem_parameter *derived_param = skadi_cap_ops_derive_arg_ro(param, sizeof(*param));

    if(!derived_param){
        /*
         * The CMT is full.
         * This usually means there is a *leak* of capabilities somewhere.
         */
        return -ENOMEM;
    }
    /*
     * Caller trampoline can be called like a normal C function.
     * Scalar/by-value parameters can be passed as-is, for pointers, we need to pass a capability.
     */
    ret = __subsystem_call(scalar, derived_param);
    /* 
     * temporal safety - drop token
     */
    (void)skadi_cap_ops_drop(derived_param);

    return ret;
}

#endif
```
