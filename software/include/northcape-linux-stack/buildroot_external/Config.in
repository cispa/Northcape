## software/include/northcape-linux-stack/buildroot_external/Config.in
```kconfig
source "$BR2_EXTERNAL_NORTHCAPE_PATH/stream/Config.in"
source "$BR2_EXTERNAL_NORTHCAPE_PATH/nc_netperf/Config.in"
source "$BR2_EXTERNAL_NORTHCAPE_PATH/pulp_timer/Config.in"
source "$BR2_EXTERNAL_NORTHCAPE_PATH/mqtt_bench/Config.in"
source "$BR2_EXTERNAL_NORTHCAPE_PATH/irq_client/Config.in"
```

## software/include/northcape-linux-stack/buildroot_external/irq_client/Config.in
```kconfig
config BR2_PACKAGE_IRQ_CLIENT
    bool "IRQ client tool support"
    depends on BR2_PACKAGE_PULP_TIMER
    help
        Driver for userspace IRQ client.
```

## software/include/northcape-linux-stack/buildroot_external/mqtt_bench/Config.in
```kconfig
config BR2_PACKAGE_MQTT_BENCH
    bool "MQTT benchmark tool"
    depends on BR2_PACKAGE_MOSQUITTO
    help
        Driver for userspace IRQ client.
```

## software/include/northcape-linux-stack/buildroot_external/nc_netperf/Config.in
```kconfig
config BR2_PACKAGE_NC_NETPERF
    bool "network performance benchmark"
    help
        Simple timestamping-based performance benchmark.
```

## software/include/northcape-linux-stack/buildroot_external/pulp_timer/Config.in
```kconfig
config BR2_PACKAGE_PULP_TIMER
    bool "PULP timer device support"
    depends on BR2_LINUX_KERNEL
    help
        Driver for PULP timer.
```

## software/include/northcape-linux-stack/buildroot_external/stream/Config.in
```kconfig
config BR2_PACKAGE_STREAM
    bool "stream benchmark"
    help
        Stream memory benchmark.

        https://github.com/jeffhammond/STREAM        

if BR2_PACKAGE_STREAM

config BR2_PACKAGE_STREAM_ARRAY_SIZE
    int "stream array size"
    default 10000000
    help
        Stream array size.
endif
```

## software/include/northcape-linux-stack/configs/linux_defconfig
```kconfig
CONFIG_DEFAULT_HOSTNAME="ariane-fpga"
# CONFIG_CROSS_MEMORY_ATTACH is not set
CONFIG_NAMESPACES=y
CONFIG_BLK_DEV_INITRD=y
CONFIG_INITRAMFS_SOURCE="${BR_BINARIES_DIR}/rootfs.cpio"
CONFIG_EMBEDDED=y
CONFIG_SMP=y
CONFIG_HZ_100=y
CONFIG_CMDLINE="earlyprintk earlycon=sbi loglevel=7 initcall_debug=1"
CONFIG_MODULES=y
# CONFIG_BLK_DEV_BSG is not set
CONFIG_PARTITION_ADVANCED=y
# CONFIG_COMPACTION is not set
CONFIG_NET=y
CONFIG_PACKET=y
CONFIG_UNIX=y
CONFIG_TLS=y
CONFIG_INET=y
CONFIG_IP_MULTICAST=y
# CONFIG_WIRELESS is not set
CONFIG_DEVTMPFS=y
CONFIG_DEVTMPFS_MOUNT=y
CONFIG_VIRTIO_BLK=y
CONFIG_EEPROM_AT24=y
CONFIG_NETDEVICES=y
CONFIG_VXLAN=y
CONFIG_XILINX_AXI_EMAC=y
CONFIG_XILINX_LL_TEMAC=y
# emaclite, for ARTY board
CONFIG_XILINX_EMACLITE=y
CONFIG_MDIO_BCM_UNIMAC=y
CONFIG_MDIO_BITBANG=y
CONFIG_MDIO_BUS_MUX_GPIO=y
CONFIG_MDIO_BUS_MUX_MMIOREG=y
CONFIG_MDIO_BUS_MUX_MULTIPLEXER=y
CONFIG_MDIO_GPIO=y
CONFIG_REALTEK_PHY=y
# CONFIG_WLAN is not set
# CONFIG_INPUT_KEYBOARD is not set
# CONFIG_INPUT_MOUSE is not set
# CONFIG_VT is not set
CONFIG_SERIAL_8250=y
CONFIG_SERIAL_8250_CONSOLE=y
CONFIG_SERIAL_OF_PLATFORM=y
#CONFIG_SERIAL_UARTLITE=y
CONFIG_SERIAL_EARLYCON_RISCV_SBI=y
CONFIG_SERIAL_EARLYCON=y
CONFIG_HVC_RISCV_SBI=n # use proper 8250 instead
CONFIG_VIRTIO_CONSOLE=n
# CONFIG_HW_RANDOM is not set
CONFIG_I2C=y
CONFIG_I2C_OCORES=y
CONFIG_I2C_XILINX=y
CONFIG_SPI=y
CONFIG_SPI_XILINX=y
CONFIG_GPIOLIB=y
CONFIG_GPIO_SYSFS=y
CONFIG_GPIO_XILINX=y
CONFIG_POWER_RESET=y
CONFIG_POWER_RESET_GPIO_RESTART=y
CONFIG_USB=y
CONFIG_USB_XHCI_HCD=y
CONFIG_USB_EHCI_HCD=y
CONFIG_MMC=y
CONFIG_MMC_SPI=y
CONFIG_NEW_LEDS=y
CONFIG_LEDS_CLASS=y
CONFIG_LEDS_PWM=y
CONFIG_LEDS_TRIGGERS=y
CONFIG_LEDS_TRIGGER_HEARTBEAT=y
CONFIG_LEDS_TRIGGER_PANIC=y
CONFIG_VIRTIO_MMIO=y
# CONFIG_IOMMU_SUPPORT is not set
CONFIG_PWM=y
CONFIG_SIFIVE_PLIC=y
CONFIG_EXT3_FS=y
# CONFIG_PROC_PAGE_MONITOR is not set
CONFIG_TMPFS=y
# CONFIG_MISC_FILESYSTEMS is not set
CONFIG_NFS_FS=y
CONFIG_NFS_V4=y
CONFIG_NFS_SWAP=y
CONFIG_NFS_V4_1=y
CONFIG_NFS_V4_2=y
CONFIG_CRYPTO_ECHAINIV=y
# CONFIG_CRYPTO_HW is not set
CONFIG_PRINTK_TIME=y
# CONFIG_STRIP_ASM_SYMS=y
CONFIG_DEBUG_SECTION_MISMATCH=y
CONFIG_STACKTRACE=y

CONFIG_HWMON=y
CONFIG_SENSORS_AXI_FAN_CONTROL=y

# debugging
CONFIG_DEBUG_KERNEL=y
CONFIG_DEBUG_INFO=y
CONFIG_DEBUG_INFO_DWARF4=y
CONFIG_DEBUG_INFO_COMPRESSED_NONE=y
CONFIG_GDB_SCRIPTS=y
CONFIG_FRAME_POINTER=y
CONFIG_KGDB=y
CONFIG_KGDB_SERIAL_CONSOLE=y
CONFIG_KGDB_KDB=y
CONFIG_KDB_KEYBOARD=y

# TODO is this needed?
CONFIG_RISCV_DMA_NONCOHERENT=y
```

## software/include/northcape-linux-stack/u-boot/configs/openhwgroup_cv64a6_genesys2_defconfig
```kconfig
CONFIG_RISCV=y
CONFIG_DEFAULT_DEVICE_TREE="cv64a6"
CONFIG_TARGET_OPENHWGROUP_CVA6_GENESYSII=y
CONFIG_ARCH_RV64I=y
CONFIG_RISCV_SMODE=y
CONFIG_OF_BOARD_SETUP=y
CONFIG_BOOTDELAY=5
CONFIG_USE_BOOTCOMMAND=y
CONFIG_BOOTCOMMAND="setenv ipaddr 10.10.10.10; tftpboot 90000000 10.10.10.1:uImage; setenv fdt_high 0xffffffffffffffff; bootm 90000000 - $(fdtcontroladdr)"
CONFIG_DISPLAY_CPUINFO=y
CONFIG_SPL_SPI_FLASH_MTD=y
CONFIG_CMD_GPT=y
# CONFIG_RANDOM_UUID is not set
CONFIG_CMD_MMC=y
CONFIG_CMD_MTD=y
CONFIG_CMD_PART=y
CONFIG_CMD_DHCP=y
CONFIG_CMD_MDIO=y
CONFIG_CMD_PING=y
CONFIG_OF_EMBED=y
CONFIG_MMC=y
# CONFIG_MMC_WRITE is not set
CONFIG_MMC_SPI=y
CONFIG_DM_MTD=y
CONFIG_MTD_SPI_NAND=y
CONFIG_SPI_FLASH_ATMEL=y
CONFIG_SPI_FLASH_EON=y
CONFIG_SPI_FLASH_GIGADEVICE=y
CONFIG_SPI_FLASH_ISSI=y
CONFIG_SPI_FLASH_MACRONIX=y
CONFIG_SPI_FLASH_SPANSION=y
CONFIG_SPI_FLASH_STMICRO=y
CONFIG_SPI_FLASH_SST=y
CONFIG_SPI_FLASH_WINBOND=y
CONFIG_SPI_FLASH_XMC=y
# CONFIG_SPI_FLASH_USE_4K_SECTORS is not set
CONFIG_SPI_FLASH_MTD=y
CONFIG_PHY_REALTEK=y
CONFIG_LOWRISC_DIGILENT_100MHZ=y
CONFIG_SYS_NS16550=y
CONFIG_SPI=y
CONFIG_XILINX_SPI=y
CONFIG_ETH=y
CONFIG_DM_ETH=y
CONFIG_DM_MDIO=y
CONFIG_DM_ETH_PHY=y
CONFIG_NETDEVICES=y
CONFIG_PHY_GIGE=y
CONFIG_XILINX_AXIEMAC=y
CONFIG_FS_FAT=y
CONFIG_FS_FAT_WRITE=y
CONFIG_CMD_FAT=y
CONFIG_PHY_REALTEK=y
CONFIG_CMD_NET=y
CONFIG_CMD_BOOTP=y
CONFIG_CMD_PING=y
CONFIG_CMD_MII=y
CONFIG_CMD_MDIO=y
CONFIG_CMD_TFTPBOOT=y
```

## software/include/northcape-zephyr-stack/boards/openhwgroup/cv64a6_arty_a7_100/Kconfig.cv64a6_arty_a7_100
```kconfig
config BOARD_CV64A6_ARTY_A7_100
    select SOC_CV64A6_IMAC
    select SOC_SERIES_CV64A6_PROVIDE_FPGA_POWEROFF
```

## software/include/northcape-zephyr-stack/boards/openhwgroup/cv64a6_arty_a7_100/board.yml
```yaml
board:
  name: cv64a6_arty_a7_100
  vendor: openhwgroup
  socs:
    - name: cv64a6
```

## software/include/northcape-zephyr-stack/boards/openhwgroup/cv64a6_arty_a7_100_nocape/Kconfig.cv64a6_arty_a7_100_nocape
```kconfig
config BOARD_CV64A6_ARTY_A7_100_NOCAPE
    select SOC_CV64A6_IMAC
    select SOC_SERIES_CV64A6_PROVIDE_FPGA_POWEROFF
```

## software/include/northcape-zephyr-stack/boards/openhwgroup/cv64a6_arty_a7_100_nocape/board.yml
```yaml
board:
  name: cv64a6_arty_a7_100_nocape
  vendor: openhwgroup
  socs:
    - name: cv64a6
```

## software/include/northcape-zephyr-stack/boards/openhwgroup/cv64a6_arty_a7_100_nocape/cv64a6_arty_a7_100_nocape_defconfig
```kconfig
CONFIG_BASE64=y
CONFIG_INCLUDE_RESET_VECTOR=y
CONFIG_CONSOLE=y
CONFIG_SERIAL=y
CONFIG_UART_CONSOLE=y
CONFIG_UART_NS16550=y
CONFIG_UART_NS16550_ACCESS_WORD_ONLY=y
CONFIG_CONSOLE_HANDLER=y
CONFIG_XIP=n
CONFIG_INIT_STACKS=y
CONFIG_SYS_CLOCK_TICKS_PER_SEC=12500000
CONFIG_SYS_CLOCK_HW_CYCLES_PER_SEC=12500000
CONFIG_FPU=n
CONFIG_POWEROFF=y

# PTP RTC
CONFIG_PTP_CLOCK_HA1588=y
CONFIG_PTP_CLOCK_HA1588_TSU=y

# RNG
CONFIG_TIMER_RANDOM_GENERATOR=y
CONFIG_TEST_RANDOM_GENERATOR=y

# IRQs
CONFIG_MULTI_LEVEL_INTERRUPTS=y
CONFIG_2ND_LEVEL_INTERRUPTS=y
# 1 PLIC
CONFIG_NUM_2ND_LEVEL_AGGREGATORS=1
CONFIG_1ST_LEVEL_INTERRUPT_BITS=7
CONFIG_2ND_LEVEL_INTERRUPT_BITS=23
CONFIG_PLIC=y
CONFIG_3RD_LEVEL_INTERRUPTS=n
CONFIG_3RD_LEVEL_INTERRUPT_BITS=0

# pulp timer
CONFIG_PULP_APB_TIMER=y

# must initialize ASAP, before other devices
# should be loaded before devices that rely on it, so should be initialized first
CONFIG_INTC_INIT_PRIORITY=0


# required for the DMA to work properly...
CONFIG_SOC_SERIES_CV64A6_PROVIDE_NONSTANDARD_CACHE_OPTIONS=y

# debug
CONFIG_DEBUG=y
CONFIG_DEBUG_OPTIMIZATIONS=y
# CONFIG_NO_OPTIMIZATIONS=y
# TODO collides with Skadi stacks at the moment
CONFIG_STACK_SENTINEL=n
CONFIG_LOG=y
# the more sophisticated modes somehow cause a read error...
CONFIG_LOG_MODE_MINIMAL=y
CONFIG_LOG_DEFAULT_LEVEL=3
CONFIG_THREAD_NAME=y
CONFIG_DEBUG_THREAD_INFO=y
# CONFIG_ASSERT=y

# earliest-possible console
CONFIG_EARLY_CONSOLE=y
CONFIG_SERIAL_INIT_PRIORITY=0
CONFIG_CONSOLE_INIT_PRIORITY=1

CONFIG_ISR_STACK_SIZE=4096
CONFIG_MAIN_STACK_SIZE=4096
CONFIG_SYSTEM_WORKQUEUE_STACK_SIZE=4096
CONFIG_IDLE_STACK_SIZE=4096

# TLS not currently available with Skadi
CONFIG_CURRENT_THREAD_USE_TLS=n

# libc
CONFIG_PICOLIBC_USE_MODULE=y
# not supported yet
CONFIG_THREAD_LOCAL_STORAGE=n

# needed for drivers to compile
CONFIG_DEVICE_STORE_DT_ID=y

# config options to test the scheduler interrupt
# forces timer ticks a few times per second, running the timer interrupt
# CONFIG_TICKLESS_KERNEL=n
CONFIG_SYS_CLOCK_TICKS_PER_SEC=1000
CONFIG_RISCV_GP=n

# not exported
CONFIG_SPIN_VALIDATE=n

# net
CONFIG_ETH_XILINX_AXI_ETHERNET_LITE=y
CONFIG_MDIO=y
CONFIG_PHY_GENERIC_MII=y
CONFIG_MDIO_XILINX_AXI_ETHERNET_LITE=y

CONFIG_ETH_DRIVER=y
CONFIG_NET_L2_ETHERNET=y
```

## software/include/northcape-zephyr-stack/boards/openhwgroup/cv64a6_genesysII/Kconfig.cv64a6_genesysII
```kconfig
config BOARD_CV64A6_GENESYSII
    select SOC_CV64A6
    select SOC_SERIES_CV64A6_PROVIDE_FPGA_POWEROFF
    select SOC_SERIES_CV64A6_HAS_CMO
```

## software/include/northcape-zephyr-stack/boards/openhwgroup/cv64a6_genesysII/board.yml
```yaml
board:
  name: cv64a6_genesysII
  vendor: openhwgroup
  socs:
    - name: cv64a6
```

## software/include/northcape-zephyr-stack/boards/openhwgroup/cv64a6_genesysII/cv64a6_genesysII_defconfig
```kconfig
CONFIG_BASE64=y
CONFIG_INCLUDE_RESET_VECTOR=y
CONFIG_CONSOLE=y
CONFIG_SERIAL=y
CONFIG_UART_CONSOLE=y
CONFIG_UART_NS16550=y
CONFIG_UART_NS16550_ACCESS_WORD_ONLY=y
CONFIG_CONSOLE_HANDLER=y
CONFIG_XIP=n
CONFIG_INIT_STACKS=y
CONFIG_SYS_CLOCK_TICKS_PER_SEC=25000000
CONFIG_FPU=y
CONFIG_POWEROFF=y

# PTP RTC
CONFIG_PTP_CLOCK_HA1588=y
CONFIG_PTP_CLOCK_HA1588_TSU=y

# RNG
CONFIG_TIMER_RANDOM_GENERATOR=y
CONFIG_TEST_RANDOM_GENERATOR=y

# IRQs
CONFIG_MULTI_LEVEL_INTERRUPTS=y
CONFIG_2ND_LEVEL_INTERRUPTS=y
# 1 PLIC
CONFIG_NUM_2ND_LEVEL_AGGREGATORS=1
CONFIG_1ST_LEVEL_INTERRUPT_BITS=7
CONFIG_2ND_LEVEL_INTERRUPT_BITS=23
CONFIG_PLIC=y
CONFIG_3RD_LEVEL_INTERRUPTS=n
CONFIG_3RD_LEVEL_INTERRUPT_BITS=0

# Ethernet / Networking
CONFIG_DMA=y
CONFIG_DMA_64BIT=y
CONFIG_DMA_XILINX_AXI_DMA=y
CONFIG_ETH_DRIVER=y
CONFIG_NET_L2_ETHERNET=y
CONFIG_ETH_XILINX_AXIENET=y
CONFIG_MDIO=y
CONFIG_PHY_GENERIC_MII=y
CONFIG_MDIO_XILINX_AXI_ENET=y
CONFIG_NET_L2_ETHERNET_MGMT=y
CONFIG_NET_PKT_RX_COUNT=32
CONFIG_NET_BUF_RX_COUNT=64
CONFIG_NET_PKT_TX_COUNT=32
CONFIG_NET_BUF_TX_COUNT=64
# 64*1514 (buffer size), rounded to nex power of 2
CONFIG_NET_PKT_BUF_RX_DATA_POOL_SIZE=131072
CONFIG_NET_PKT_BUF_TX_DATA_POOL_SIZE=131072
CONFIG_NET_TC_RX_COUNT=1
CONFIG_NET_TC_TX_COUNT=1

CONFIG_NET_BUF_VARIABLE_DATA_SIZE=y

# need to init DMA before ethernet, as ethernet uses DMA
CONFIG_DMA_INIT_PRIORITY=79
CONFIG_ETH_INIT_PRIORITY=80

CONFIG_NETWORKING=y
CONFIG_NET_IPV4=y
CONFIG_NET_TCP=y
# IPV6 not selected - depends on board
CONFIG_NET_CONFIG_SETTINGS=y
CONFIG_NET_CONFIG_NEED_IPV4=y
CONFIG_NET_CONFIG_MY_IPV4_ADDR="192.0.2.1"
CONFIG_NET_CONFIG_PEER_IPV4_ADDR="192.0.2.2"

CONFIG_PTP_CLOCK_HA1588=y

CONFIG_SKADI_NET_ZEROCOPY=y

# pulp timer
CONFIG_PULP_APB_TIMER=y

# must initialize ASAP, before other devices
# should be loaded before devices that rely on it, so should be initialized first
CONFIG_INTC_INIT_PRIORITY=0

# DMA_XILINX_AXI_DMA_LOCK_CHANNEL_IRQ will not work with CONFIG_NET_TC_RX_COUNT=0
# the RX handler might trigger TX
# CONFIG_DMA_XILINX_AXI_DMA_LOCK_DMA_IRQS will not work with CONFIG_NET_TC_RX_COUNT!=0
# TX can be triggered from thread, which may start with scheduler IRQ
# so we have to lock all IRQs to be safe
CONFIG_DMA_XILINX_AXI_DMA_LOCK_ALL_IRQS=y
CONFIG_DMA_XILINX_AXI_DMA_SG_DESCRIPTOR_NUM_RX=8
CONFIG_DMA_XILINX_AXI_DMA_SG_DESCRIPTOR_NUM_TX=8

# immediately raise interrupt on RX
CONFIG_DMA_XILINX_AXI_DMA_INTERRUPT_THRESHOLD=1

CONFIG_DMA_LOG_LEVEL_WRN=y

CONFIG_SOC_SERIES_CV64A6_PROVIDE_NONSTANDARD_CACHE_OPTIONS=y
# cache integration will handle this
CONFIG_DMA_XILINX_AXI_DMA_DISABLE_CACHE_WHEN_ACCESSING_SG_DESCRIPTORS=n

# debug
# CONFIG_DEBUG=y
# CONFIG_DEBUG_OPTIMIZATIONS=y
# CONFIG_SPEED_OPTIMIZATIONS=y
# CONFIG_NO_OPTIMIZATIONS=y
# TODO collides with Skadi stacks at the moment
CONFIG_STACK_SENTINEL=n
CONFIG_LOG=y
CONFIG_LOG_MODE_MINIMAL=y
CONFIG_LOG_DEFAULT_LEVEL=3
CONFIG_THREAD_NAME=n
CONFIG_DEBUG_THREAD_INFO=n
# CONFIG_SKADI_SUBSYSTEM_CALL_NOCHECKS=y
# CONFIG_ASSERT=y

# earliest-possible console
CONFIG_EARLY_CONSOLE=y
CONFIG_SERIAL_INIT_PRIORITY=0
CONFIG_CONSOLE_INIT_PRIORITY=1

CONFIG_ISR_STACK_SIZE=4096
CONFIG_MAIN_STACK_SIZE=4096
CONFIG_SYSTEM_WORKQUEUE_STACK_SIZE=4096
CONFIG_IDLE_STACK_SIZE=4096
CONFIG_NET_TCP_WORKQ_STACK_SIZE=4096
CONFIG_NET_TX_STACK_SIZE=4096
CONFIG_NET_RX_STACK_SIZE=4096
CONFIG_NET_MGMT_EVENT_STACK_SIZE=4096

# TLS not currently available with Skadi
CONFIG_CURRENT_THREAD_USE_TLS=n

# libc
CONFIG_PICOLIBC_USE_MODULE=y
# not supported yet
CONFIG_THREAD_LOCAL_STORAGE=n

# LLEXT
CONFIG_LLEXT=y
# build/expect binary
CONFIG_LLEXT_TYPE_ELF_RELOCATABLE=y
# no (additional) copying of the ELFs
CONFIG_LLEXT_STORAGE_WRITABLE=n
CONFIG_LLEXT_LOG_LEVEL_WRN=y
# 128 kb
CONFIG_LLEXT_HEAP_SIZE=128
CONFIG_LLEXT_EXPORT_DEVICES=y
CONFIG_LLEXT_SYMBOL_GC=y

# Skadi
CONFIG_SKADI_OS=y
CONFIG_SKADI_LOG_LEVEL_INF=y
CONFIG_SKADI_SUBSYSTEM_LOG_LEVEL_INF=y
CONFIG_SKADI_GENESYSII=y
CONFIG_SKADI_ISR_STACK_SIZE=1024
# PLIC is loaded at run time
CONFIG_SOC_SERIES_CV64A6_HAS_PLIC=n
# TODO during transition to fully compartmentalized OS, run sched in task 0
CONFIG_SKADI_SCHEDULER_RUNS_WITH_LOADER_TASK_ID=n
# this can overflow when prints are involved, especially in shell subsystem
CONFIG_SKADI_SUBSYSTEM_STACK_SIZE=8191
CONFIG_SKADI_LIBC_HAS_NO_TID_PROTECTION=y
CONFIG_BOOT_BANNER_STRING="Booting Skadi OS build"
CONFIG_SKADI_NUUK=y
CONFIG_SKADI_CACHE_INTEGRATION=y
CONFIG_SKADI_RESET_BRANCH_TABLE_ON_SUBSYSTEM_CALL=n
CONFIG_SKADI_LIBC_INLINE=y
# subsystem call options ARE supported
CONFIG_SKADI_SUBSYSTEM_CALL_INSTRUCTIONS=y
# fast reg zero options ARE supported
CONFIG_SKADI_FAST_REG_ZERO_INSTRUCTION=y
# access to operations via CSRs and MMIO is supported
CONFIG_SKADI_OPS_MODULE_CSRS=y
# CONFIG_SKADI_OPS_MODULE_MMIO=y

CONFIG_SKADI_ALLOCATOR_FIRST_FIT=y

# needed for drivers to compile
CONFIG_DEVICE_STORE_DT_ID=y

# CONFIG_SKADI_DEBUG=y
# CONFIG_SKADI_ALLOCATOR_DEBUG=y
# CONFIG_SKADI_DEBUG_UNRESTRICTED_ROOT_CAP=y
# CONFIG_SKADI_DEBUG_UNRESTRICTED_STACK=y
# CONFIG_SKADI_DISABLE_TASK_RESTRICTION_FOR_CODE_DATA=y
# CONFIG_SKADI_DISABLE_WRITE_PREVENTION_FOR_CODE_RO_DATA=y
# CONFIG_SKADI_TRACK_CYCLES_OPS=y
# CONFIG_SKADI_COUNT_SUBSYSTEM_CALLS=y
# CONFIG_SKADI_COUNT_SUBSYSTEM_CALL_ALLOC_ITERATIONS=y
# CONFIG_SKADI_COUNT_YIELD_CALLS=y

CONFIG_SKADI_OS_DEBUG_CAP_NUM=n
# config options to test the scheduler interrupt
# forces timer ticks a few times per second, running the timer interrupt
# CONFIG_TICKLESS_KERNEL=n
# TODO default value (=hardware clock ticks) crashes inexplicably in MQTT, but slightly reduced values work fine
CONFIG_SYS_CLOCK_TICKS_PER_SEC=10000
CONFIG_SKADI_ASSUME_IRQ_REGFILE=y
CONFIG_RISCV_GP=n
CONFIG_SKADI_LIBRARY_LOCAL_CLOCK=y
# CONFIG_SKADI_TRACK_CYCLES_OPS=y

# not exported
CONFIG_SPIN_VALIDATE=n

# global per-subsystem pool - can be relatively large
CONFIG_SKADI_SUBSYSTEM_CALLER_TRAMPOLINE_NUM_REGISTER_SETS=16
CONFIG_SKADI_SUBSYSTEM_CALLEE_TRAMPOLINE_NUM_STACKS=32
```

## software/include/northcape-zephyr-stack/boards/openhwgroup/cv64a6_genesysII_nocape/board.yml
```yaml
board:
  name: cv64a6_genesysII_nocape
  vendor: openhwgroup
  socs:
    - name: cv64a6
```
