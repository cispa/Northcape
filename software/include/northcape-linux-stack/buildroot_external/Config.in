## software/include/northcape-zephyr-stack/boards/openhwgroup/cv64a6_genesysII_nocape/cv64a6_genesysII_nocape_defconfig
```kconfig
CONFIG_BASE64=y
CONFIG_INCLUDE_RESET_VECTOR=y
CONFIG_CONSOLE=y
CONFIG_SERIAL=y
CONFIG_UART_CONSOLE=y
CONFIG_UART_NS16550=y
CONFIG_UART_NS16550_ACCESS_WORD_ONLY=y
CONFIG_CONSOLE_HANDLER=y
CONFIG_XIP=n
CONFIG_INIT_STACKS=y
CONFIG_SYS_CLOCK_TICKS_PER_SEC=25000000
CONFIG_FPU=y
CONFIG_POWEROFF=y

# PTP RTC
CONFIG_PTP_CLOCK_HA1588=y
CONFIG_PTP_CLOCK_HA1588_TSU=y

# RNG
CONFIG_TIMER_RANDOM_GENERATOR=y
CONFIG_TEST_RANDOM_GENERATOR=y

# IRQs
CONFIG_MULTI_LEVEL_INTERRUPTS=y
CONFIG_2ND_LEVEL_INTERRUPTS=y
# 1 PLIC
CONFIG_NUM_2ND_LEVEL_AGGREGATORS=1
CONFIG_1ST_LEVEL_INTERRUPT_BITS=7
CONFIG_2ND_LEVEL_INTERRUPT_BITS=23
CONFIG_PLIC=y
CONFIG_3RD_LEVEL_INTERRUPTS=n
CONFIG_3RD_LEVEL_INTERRUPT_BITS=0

# Ethernet / Networking
CONFIG_DMA=y
CONFIG_DMA_64BIT=y
CONFIG_DMA_XILINX_AXI_DMA=y
CONFIG_ETH_DRIVER=y
CONFIG_NET_L2_ETHERNET=y
CONFIG_ETH_XILINX_AXIENET=y
CONFIG_MDIO=y
CONFIG_PHY_GENERIC_MII=y
CONFIG_MDIO_XILINX_AXI_ENET=y
CONFIG_NET_PKT_RX_COUNT=32
CONFIG_NET_BUF_RX_COUNT=64
CONFIG_NET_PKT_TX_COUNT=32
CONFIG_NET_BUF_TX_COUNT=64
# 64*1514 (buffer size), rounded to nex power of 2
CONFIG_NET_PKT_BUF_RX_DATA_POOL_SIZE=131072
CONFIG_NET_PKT_BUF_TX_DATA_POOL_SIZE=131072
CONFIG_NET_TC_RX_COUNT=1
CONFIG_NET_TC_TX_COUNT=1

CONFIG_NET_BUF_VARIABLE_DATA_SIZE=y

# need to init DMA before ethernet, as ethernet uses DMA
CONFIG_DMA_INIT_PRIORITY=79
CONFIG_ETH_INIT_PRIORITY=80

CONFIG_NETWORKING=y
CONFIG_NET_IPV4=y
CONFIG_NET_TCP=y
CONFIG_NET_IPV6=n
CONFIG_NET_CONFIG_SETTINGS=y
CONFIG_NET_CONFIG_NEED_IPV4=y
CONFIG_NET_CONFIG_MY_IPV4_ADDR="192.0.2.1"
CONFIG_NET_CONFIG_PEER_IPV4_ADDR="192.0.2.2"

# pulp timer
CONFIG_PULP_APB_TIMER=y

# must initialize ASAP, before other devices
# should be loaded before devices that rely on it, so should be initialized first
CONFIG_INTC_INIT_PRIORITY=0

# DMA_XILINX_AXI_DMA_LOCK_CHANNEL_IRQ will not work with CONFIG_NET_TC_RX_COUNT=0
# the RX handler might trigger TX
# CONFIG_DMA_XILINX_AXI_DMA_LOCK_DMA_IRQS will not work with CONFIG_NET_TC_RX_COUNT!=0
# TX can be triggered from thread, which may start with scheduler IRQ
# so we have to lock all IRQs to be safe
CONFIG_DMA_XILINX_AXI_DMA_LOCK_DMA_IRQS=y
CONFIG_DMA_XILINX_AXI_DMA_SG_DESCRIPTOR_NUM_RX=8
CONFIG_DMA_XILINX_AXI_DMA_SG_DESCRIPTOR_NUM_TX=8
# not needed
CONFIG_DMA_XILINX_AXI_DMA_POLL_INTERVAL=0

# immediately raise interrupt on RX
CONFIG_DMA_XILINX_AXI_DMA_INTERRUPT_THRESHOLD=1

CONFIG_DMA_LOG_LEVEL_WRN=y

# required for the DMA to work properly...
CONFIG_SOC_SERIES_CV64A6_PROVIDE_NONSTANDARD_CACHE_OPTIONS=y
CONFIG_DMA_XILINX_AXI_DMA_DISABLE_CACHE_WHEN_ACCESSING_SG_DESCRIPTORS=y

# debug
CONFIG_DEBUG=y
CONFIG_DEBUG_OPTIMIZATIONS=y
# CONFIG_NO_OPTIMIZATIONS=y
# TODO collides with Skadi stacks at the moment
CONFIG_STACK_SENTINEL=n
CONFIG_LOG=y
# the more sophisticated modes somehow cause a read error...
CONFIG_LOG_MODE_MINIMAL=y
CONFIG_LOG_DEFAULT_LEVEL=3
CONFIG_THREAD_NAME=y
CONFIG_DEBUG_THREAD_INFO=y
CONFIG_ASSERT=y

# earliest-possible console
CONFIG_EARLY_CONSOLE=y
CONFIG_SERIAL_INIT_PRIORITY=0
CONFIG_CONSOLE_INIT_PRIORITY=1

CONFIG_ISR_STACK_SIZE=4096
CONFIG_MAIN_STACK_SIZE=4096
CONFIG_SYSTEM_WORKQUEUE_STACK_SIZE=4096
CONFIG_IDLE_STACK_SIZE=4096
CONFIG_NET_TCP_WORKQ_STACK_SIZE=4096
CONFIG_NET_TX_STACK_SIZE=4096
CONFIG_NET_RX_STACK_SIZE=4096
CONFIG_NET_MGMT_EVENT_STACK_SIZE=4096

# TLS not currently available with Skadi
CONFIG_CURRENT_THREAD_USE_TLS=n

# libc
CONFIG_PICOLIBC_USE_MODULE=y
# not supported yet
CONFIG_THREAD_LOCAL_STORAGE=n

# needed for drivers to compile
CONFIG_DEVICE_STORE_DT_ID=y

# config options to test the scheduler interrupt
# forces timer ticks a few times per second, running the timer interrupt
# CONFIG_TICKLESS_KERNEL=n
CONFIG_SYS_CLOCK_TICKS_PER_SEC=10
CONFIG_RISCV_GP=n

# not exported
CONFIG_SPIN_VALIDATE=n
```

## software/include/northcape-zephyr-stack/boards/openhwgroup/cv64a6_northern_lights/Kconfig.cv64a6_northern_lights
```kconfig
config BOARD_CV64A6_NORTHERN_LIGHTS
    select SOC_CV64A6
    select SOC_SERIES_CV64A6_PROVIDE_FPGA_POWEROFF
```

## software/include/northcape-zephyr-stack/boards/openhwgroup/cv64a6_northern_lights/board.yml
```yaml
board:
  name: cv64a6_northern_lights
  vendor: openhwgroup
  socs:
    - name: cv64a6
```

## software/include/northcape-zephyr-stack/boards/openhwgroup/cv64a6_testbench/board.yml
```yaml
board:
  name: cv64a6_testbench
  vendor: openhwgroup
  socs:
    - name: cv64a6
```

## software/include/northcape-zephyr-stack/drivers/ethernet/Kconfig.xilinx_axienet
```kconfig
#
#Xilinx AXI 1G / 2.5G Ethernet Subsystem
#
#
#SPDX - License - Identifier : Apache - 2.0
#

menuconfig ETH_XILINX_AXIENET
	bool "Xilinx AXI Ethernet Driver"
	default y
	depends on DT_HAS_XLNX_AXI_ETHERNET_7_2_ENABLED || DT_HAS_XLNX_AXI_ETHERNET_1_00_A_ENABLED
	depends on DT_HAS_XLNX_ETH_DMA_ENABLED && DMA_XILINX_AXI_DMA
	depends on NETWORKING
	help 
		Enable Xilinx 1G / 2.5G AXI Ethernet driver,
		commonly found on FPGAs. Depends on Xilinx AXI DMA.

config ETH_XILINX_AXIENET_BUFFER_NUM_TX
	int "Number of buffers for concurrent transmission (TX)."
	depends on ETH_XILINX_AXIENET
	default DMA_XILINX_AXI_DMA_SG_DESCRIPTOR_NUM_TX if DMA_XILINX_AXI_DMA_SG_DESCRIPTOR_NUM_TX > 0
	default 1
	help
		Number of buffers for transmission allocated in the Xilinx AXI Ethernet driver.
		This limits how many transmissions can be in-flight at the same time.
		This cannot exceed the number of available TX buffers in the AXI DMA. However,
		in scenarios with multiple AXI DMAs for different purposes in the system, it
		may be desirable to reduce the number of concurrent transmissions to conserve
		resources.

config ETH_XILINX_AXIENET_BUFFER_NUM_RX
	int "Number of buffers for concurrent reception (RX)."
	depends on ETH_XILINX_AXIENET
	default DMA_XILINX_AXI_DMA_SG_DESCRIPTOR_NUM_RX
	range 1 DMA_XILINX_AXI_DMA_SG_DESCRIPTOR_NUM_RX
	help
		Number of buffers for reception allocated in the Xilinx AXI Ethernet driver.
		This limits how many transmissions can be in-flight at the same time.
		This cannot exceed the number of available RX buffers in the AXI DMA. However,
		in scenarios with multiple AXI DMAs for different purposes in the system, it
		may be desirable to reduce the number of concurrent transmissions to conserve
		resources.

config ETH_XILINX_AXIENET_FRAGMENTS_MAX
	int "Maximum TX fragments"
	depends on SKADI_LOADER
	default ETH_XILINX_AXIENET_BUFFER_NUM_TX if ETH_XILINX_AXIENET_BUFFER_NUM_TX > 0
	default 1
	help
		Number of fragments of a single packet that is used by the AXI ENET.
```

## software/include/northcape-zephyr-stack/drivers/ptp_clock/Kconfig.ha1588
```kconfig
#  gGmbH
# SPDX-License-Identifier: Apache-2.0

config PTP_CLOCK_HA1588
	bool "HA1588 PTP Clock driver"
	default y
	depends on DT_HAS_HA1588_RTC_1_0_ENABLED && NET_L2_PTP
	help
	  Enable ha1588 PTP clock support.

if PTP_CLOCK_HA1588

config PTP_CLOCK_HA1588_TSU
  bool "HA1588 TSU support"
  help
    Enable driver support for ha1588 Time-Stamp Unit.
    Used in hardware designs where Ethernet MAC lacks
    timestamping functionality.

config HA155_TIMESTAMP_ALL_RX
	bool "Timestamp all incoming packets in Xilinx AXI ENET"
	depends on NET_PKT_TIMESTAMP
	help
		Select to timestamp all incoming packets rather than just PTP packets.

config HA155_TIMESTAMP_ALL_TX
	bool "Timestamp all outgoing packets in Xilinx AXI ENET"
	depends on NET_PKT_TIMESTAMP
	help
		Select to timestamp all outgoing packets rather than just PTP packets.

endif
```

## software/include/northcape-zephyr-stack/drivers/timer/Kconfig.pulp_apb_timer
```kconfig
# Copyright (c) 2014-2015 Wind River Systems, Inc.
# Copyright (c) 2016 Cadence Design Systems, Inc.
# Copyright (c) 2019 Intel Corp.
# SPDX-License-Identifier: Apache-2.0

config PULP_APB_TIMER
	bool "Pulp APB timer"
	depends on DT_HAS_PULP_APB_TIMER_ENABLED
	help
	  This module implements a kernel device driver for the APB timer from the Pulp platform.

config PULP_APB_TIMER_INIT_PRIORITY
	int "Pulp APB timer Initialization Priority"
	depends on PULP_APB_TIMER
	range 0 99
	default 1
```

## software/include/northcape-zephyr-stack/dts/bindings/ethernet/ha1588,rtc-1.0.yaml
```yaml
#  gGmbH
# SPDX-License-Identifier: Apache-2.0

description: ha1588 PTP (Precision Time Protocol) Clock and TSU

compatible: "ha1588,rtc-1.0"

include: ["base.yaml"]

properties:
  ha1588,period:
    required: true
    type: array
    description: Nominal period of ha1588 RTC clock.
  ha1588,tsu:
    required: true
    type: boolean
    description: Does the ha1588 instance have the time stamping unit enabled?
  ha1588,ts-all-supported:
    required: true
    type: boolean
    description: Does the ha1588 instance have a TSU that can timestamp all incoming packets (including non-TSU packets)?
```
